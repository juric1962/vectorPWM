#include "utils.h"
#include "string.h"
#include <stdlib.h>
#include <stdio.h>
#include <stdint.h>
#include <math.h>
#include "scenario_softAP.h"
#include "modbus.h"
#include "dynaGram.h"
//using namespace std;

//#define _CRT_SECURE_NO_WARNINGS
extern uint8_t inBuffer[MAX_LEN_BUFFER], outBuffer[MAX_LEN_BUFFER]; 
char HTMLString[MAX_SIZE_HTML_PACKET];
// Счетчик элементов в массиве htmlList
int CountItemInHtmlList = 0;
ThtmlItem htmlList[MAX_HTML_ITEM];

char SectionName[SECTION_SIZE];
char ColorHtmlText;
int CurrentArhiveIndex, LastArhiveIndex;
// Флаг = 0 если последний индекс архива не прочитан
char FlagReadLastArhiveIndex = 0;
extern char comand_WiFi;
extern volatile uint8_t rinatTimer;



const char ArrSection_2[MAX_ARRSECTION_2][SECTION_SIZE] = {
   "ПРЕДЫДУЩИЙ",
   "СЛЕДУЩИЙ",
   "ТЕКУЩИЙ"
};


///* все объявления будут в файлах initParam.c InitParam1.c
extern const char ArrSection[MAX_ARRSECTION][SECTION_SIZE];
extern const char ArrSection_1[MAX_ARRSECTION_1][SECTION_SIZE];
extern const TParamItem ParamItem[MAX_PARAM_ITEM];
extern const TParamItem ParamItem_1[MAX_PARAM_ITEM_1];
//*/  

// это закоментарить

/*
const char ArrSection[MAX_ARRSECTION][SECTION_SIZE] = {
   "Время",
   "ЭТР",
   "Перегруз по току",
   "Перекос тока",
   "Перенапряжение",
   "Холостой Ход",
   "Низкое напряжение",
   "Температура",
   "ПЧ",
   "ПИД",
   "Огр пуск тока",
   "Подхват частоты",
   "ТИТ",
   "АО",
   "ТИИ",
   "MOTOR",
   "Fmin",
   "Fmid",
   "Fmax",
   "Fmid point",
   "Старт-частота(Гц)",
   "Разгон(Гц/c)",
   "Торможение(Гц/с)",
   "S х-ка разгона(с)",
   "S х-ка торможения(с)",
   "Номер U(F)",
   "Источник частоты: 0-MB,1-ТИТ1,2-ТИТ2",
   "Контекст",
   "Счетчики событий",
   "ARH(привязка входа ТС (0-15))",
   "ARH(интервал, мин)",
   "ARH",
   "ДИНАМОГР",
   "ДИНАМОГР АВАР",
   "ДИНАМОГР АЛГ",
   "Modbus адрес"
};

const char ArrSection_1[MAX_ARRSECTION_1][SECTION_SIZE] = {
   "ТОКИ",
   "НАПРЯЖЕНИЯ",
   "МОЩНОСТЬ",
   "COS",
   "МОМЕНТ",
   "ТЕМПЕРАТУРА",
   "СОСТОЯНИЯ",
   "ЧАСТОТА",
   "ТЕКУЩИЕ ТИТ ТС ТУ",
   "ДИАГНОСТИКА RS232_485",
   "ДИАГНОСТИКА ПЕРИФЕРИИ",
   "Max время выполнения задачи",
   "ТЕКУЩИЕ ЗНАЧЕНИЯ ЭТР",
   "Текущий АПВ",
   "СОБЫТИЯ",
   "ДИНАМОГРАММА",
   "ДИНАМОГРАММА. СВОЙСТВА",
   "ВАТГРАММА",
   "ПЕРЕМЕЩЕНИЕ",
   "ВЕРСИЯ"
};


const TParamItem ParamItem[MAX_PARAM_ITEM] = {
   "Секунды(0-59)", 10, UINT, 255, 1, false, 0,
   "Минуты(0-59)", 11, UINT, 255, 1, false, 0,
   "Часы(0-23)", 12, UINT, 255, 1, false, 0,
   "День(1-31)", 13, UINT, 255, 1, false, 0,
   "Месяц(1-12)", 14, UINT, 255, 1, false, 0,
   "Год(+2000)", 15, UINT, 255, 1, false, 0,
   "Вторая точка частотной корректировки тока(Гц)", 20, REAL, 255, 1, false, 1,
   "Третья точка частотной корректировки тока(Гц)", 22, REAL, 255, 1, false, 1,
   "Первый поправочный коэффициент тока(%)", 24, REAL, 255, 1, false, 1,
   "Второй поправочный коэффициент тока(%)", 26, REAL, 255, 1, false, 1,
   "Третий поправочный коэффициент тока(%)", 28, REAL, 255, 1, false, 1,
   "Четвертый поправочный коэффициент тока(%)", 30, REAL, 255, 1, false, 1,
   "Аварийная уставка относительно Iном(%)", 32, UINT, 255, 1, false, 1,
   "Процент относительно аварийного счетчика ЭТР, позволяющий возобновить работу", 33, UINT, 255, 1, false, 1,
   "Аварийная уставка по времени(с)", 34, UINT, 255, 1, false, 1,
   "Наличие внешнего охлаждения: 0-нет, 1-есть ", 35, UINT, 255, 1, false, 1,
   "Состояние защиты: 0-выкл, 1-вкл, 2-сброс счетчика ", 36, UINT, 255, 1, false, 1,
   "Дейстующее значение тока(%) от ном", 52, UINT, 255, 1, false, 2,
   "Время удержания действующего значения тока(мс)", 53, UINT, 255, 1, false, 2,
   "Max значение счетчика АПВ", 54, UINT, 255, 1, false, 2,
   "Время декрементирования счетчика АПВ(мин)", 55, UINT, 255, 1, false, 2,
   "Величина тока обрыва фазы(%) от ном", 56, UINT, 255, 1, false, 3,
   "Время удержания обрыва фазы(мс)", 57, UINT, 255, 1, false, 3,
   "Дисбаланс тока(%) от ном", 58, UINT, 255, 1, false, 3,
   "Время удержания дисбаланса тока(мс)", 59, UINT, 255, 1, false, 3,
   "Max значение счетчика АПВ", 60, UINT, 255, 1, false, 3,
   "Время декрементирования счетчика АПВ(мин)", 61, UINT, 255, 1, false, 3,
   "Max значение счетчика АПВ", 62, UINT, 255, 1, false, 4,
   "Время декрементирования счетчика АПВ(мин)", 63, UINT, 255, 1, false, 4,
   "Активная мощность(Вт)", 64, UINT, 255, 1, false, 5,
   "Время удержания(с)", 65, UINT, 255, 1, false, 5,
   "Max значение счетчика АПВ", 66, UINT, 255, 1, false, 5,
   "Время декрементирования счетчика АПВ(мин)", 67, UINT, 255, 1, false, 5,
   "Max значение счетчика АПВ", 68, UINT, 255, 1, false, 1,
   "Время декрементирования счетчика АПВ(мин)", 69, UINT, 255, 1, false, 1,
   "Max значение счетчика АПВ", 70, UINT, 255, 1, false, 6,
   "Время декрементирования счетчика АПВ(мин)", 71, UINT, 255, 1, false, 6,
   "Разрешение работы в этом режиме(>0-разрешено)", 72, UINT, 255, 1, false, 6,
   "Напряжение для перехода в режим РФЧ(фиксированной частоты)(В)", 73, UINT, 255, 1, false, 6,
   "Время удержания напряжения(мс)", 74, UINT, 255, 1, false, 6,
   "Размах 100Гц гармоники для перехода в РФЧ(В)", 75, UINT, 255, 1, false, 6,
   "Время удержания размаха 100Гц гармоники(мс)", 76, UINT, 255, 1, false, 6,
   "Max частота в режиме РФЧ(Гц)", 77, UINT, 255, 1, false, 6,
   "Кол-во попыток выхода из РФЧ(0-сразу переход в аварию)", 78, UINT, 255, 1, false, 6,
   "Периодичность выхода из РФЧ(0-не выходить)(мин)", 79, UINT, 255, 1, false, 6,
   "Период сброса счетчика попыток выхода из РФЧ(0-не сбрасывать)(мин) ", 80, UINT, 255, 1, false, 6,
   "Max значение счетчика АПВ", 81, UINT, 255, 1, false, 7,
   "Время декрементирования счетчика АПВ(мин)", 82, UINT, 255, 1, false, 7,
   "Аварийная температура отсека конденсаторов(0С)", 83, UINT, 255, 1, false, 7,
   "Температура конденсаторов, допускающая возобновление работы(0С)", 84, UINT, 255, 1, false, 7,
   "Аварийная температура радиатора(0С)", 85, UINT, 255, 1, false, 7,
   "Температура радиатора, допускающая возобновление работы(0С)", 86, UINT, 255, 1, false, 7,
   "Частота для установки", 100, REAL, 255, 1, false, 8,
   "Стабилизация напряжения(>0-вкл)", 102, UINT, 255, 1, false, 8,
   "Направление вращения(0-по часовой,1-против)", 103, UINT, 255, 1, false, 8,
   "Останов двигателя по модбас в режиме ЧРЭП(>0)", 104, UINT, 255, 1, false, 8,
   "Задержка на включении после аварии в режимах ЧРЭП и КП(с)", 105, UINT, 255, 1, false, 8,
   "Задержка перед пуском в режиме КП(с)", 106, UINT, 255, 1, false, 8,
   "Сброс аварий(>0)", 107, UINT, 255, 1, false, 8,
   "Автономный режим работы: 0-ЧРЭП, 1-КП", 108, UINT, 255, 1, false, 8,
   "Температура вкл вентиляторов и ТУ3(0С)", 110, UINT, 255, 1, false, 8,
   "Гистерезис температуры вкл/выкл вентиляторов и ТУ3(0С)", 111, UINT, 255, 1, false, 8,
   "Режим отладочного порта:0 - отладка, 1 - ModBus Slave", 298, UINT, 255, 1, false, 8,
   "Номер контекста после пуска(1-10), 0 — пусковой и рабочий контекст совпадают", 132, UINT, 255, 1, false, 8,
   "Предельно допустимое увеличение частоты(Гц)", 112, UINT, 255, 1, false, 9,
   "Величина стабилизации мощности (Вт)", 114, REAL, 255, 1, false, 9,
   "Пропорциональный коэффициент", 116, REAL, 255, 1, false, 9,
   "Интегральный коэффициент", 118, REAL, 255, 1, false, 9,
   "Дифференциальный коэффициент", 120, REAL, 255, 1, false, 9,
   "Ограничение на Max изменение фазы напряжения", 122, REAL, 255, 1, false, 9,
   "Нижний предел отключения ПИД-регулятора(Вт)", 124, UINT, 255, 1, false, 9,
   "Верхний предел включения ПИД-регулятора(Вт)", 125, UINT, 255, 1, false, 9,
   "Величина игнорируемой входной ошибки(Вт)", 129, UINT, 255, 1, false, 9,
   "Ток увеличения частоты статора(А)", 126, UINT, 255, 1, false, 10,
   "Ток удержания частоты статора(А)", 127, UINT, 255, 1, false, 10,
   "Время удержания стартовой частоты статора(>0-вкл)(мс)", 128, UINT, 255, 1, false, 10,
   "Действующее напряжение «подхвата» вращающегося ротора(В)", 130, UINT, 255, 1, false, 11,
   "Разрешение «подхвата» вращающегося ротора(>0-вкл)", 131, UINT, 255, 1, false, 11,
   "Min частота, соотв min напряжению ТИТ1(Гц)", 140, UINT, 255, 1, false, 12,
   "Min частота, соотв min напряжению ТИТ2(Гц)", 141, UINT, 255, 1, false, 12,
   "Max частота, соотв max напряжению ТИТ1(Гц)", 142, UINT, 255, 1, false, 12,
   "Max частота, соотв max напряжению ТИТ2(Гц)", 143, UINT, 255, 1, false, 12,
   "Min напряжение ТИТ1(мВ)", 144, UINT, 255, 1, false, 12,
   "Min напряжение ТИТ2(мВ)", 145, UINT, 255, 1, false, 12,
   "Max напряжение ТИТ1(мВ)", 146, UINT, 255, 1, false, 12,
   "Max напряжение ТИТ2(мВ)", 147, UINT, 255, 1, false, 12,
   "Время усреднения ТИТ1(мс)", 148, UINT, 255, 1, false, 12,
   "Время усреднения ТИТ2(мс)", 149, UINT, 255, 1, false, 12,
   "Время усреднения ТИТ3(мс)", 150, UINT, 255, 1, false, 12,
   "Время усреднения ТИТ4(мс)", 151, UINT, 255, 1, false, 12,
   "ДжиттерРазница ТИТ1(мВ)", 152, UINT, 255, 1, false, 12,
   "ДжиттерРазница ТИТ2(мВ)", 153, UINT, 255, 1, false, 12,
   "Чувствительность ТИТ1(в 0,01 Гц)", 154, UINT, 255, 1, false, 12,
   "Чувствительность ТИТ2(в 0,01 Гц)", 155, UINT, 255, 1, false, 12,
   "Min значение измеряемой величины, соотв min напряжению AO1(мВ)", 160, REAL, 255, 1, false, 13,
   "Min значение измеряемой величины, соотв min напряжению AO2(мВ)", 162, REAL, 255, 1, false, 13,
   "Max значение измеряемой величины, соотв max напряжению AO1(мВ)", 164, REAL, 255, 1, false, 13,
   "Max значение измеряемой величины, соотв max напряжению AO2(мВ)", 166, REAL, 255, 1, false, 13,
   "Min напряжение AO1(мВ)", 168, UINT, 255, 1, false, 13,
   "Min напряжение AO2(мВ)", 169, UINT, 255, 1, false, 13,
   "Max напряжение AO1(мВ)", 170, UINT, 255, 1, false, 13,
   "Max напряжение AO2(мВ)", 171, UINT, 255, 1, false, 13,
   "Источник сигнала AO1: 0-выкл, 1-Fвых, 2-об/мин, 3-Pакт, 4-текущий момент", 172, UINT, 255, 1, false, 13,
   "Источник сигнала AO2: 0-выкл, 1-Fвых, 2-об/мин, 3-Pакт, 4-текущий момент", 173, UINT, 255, 1, false, 13,
   "ТИИ1", 180, UINT, 255, 1, false, 14,
   "ТИИ2", 181, UINT, 255, 1, false, 14,
   "ТИИ3", 182, UINT, 255, 1, false, 14,
   "ТИИ4", 183, UINT, 255, 1, false, 14,
   "ТИИ5", 184, UINT, 255, 1, false, 14,
   "ТИИ6", 185, UINT, 255, 1, false, 14,
   "ТИИ7", 186, UINT, 255, 1, false, 14,
   "ТИИ8", 187, UINT, 255, 1, false, 14,
   "ТИИ9", 188, UINT, 255, 1, false, 14,
   "ТИИ10", 189, UINT, 255, 1, false, 14,
   "ТИИ11", 190, UINT, 255, 1, false, 14,
   "ТИИ12", 191, UINT, 255, 1, false, 14,
   "ТИИ13", 192, UINT, 255, 1, false, 14,
   "ТИИ14", 193, UINT, 255, 1, false, 14,
   "ТИИ15", 194, UINT, 255, 1, false, 14,
   "Номинальный ток(А)", 200, REAL, 255, 1, false, 15,
   "Ток холостого хода(А)", 202, REAL, 255, 1, false, 15,
   "Номинальная скорость(об/мин)", 204, REAL, 255, 1, false, 15,
   "Номинальная частота(Гц)", 206, REAL, 255, 1, false, 15,
   "Номинальная мощность(Вт)", 208, REAL, 255, 1, false, 15,
   "КПД двигателя", 210, REAL, 255, 1, false, 15,
   "Min частота для установки Fmin(Гц)", 212, REAL, 255, 1, false, 15,
   "Max частота для установки Fmax(Гц)", 214, REAL, 255, 1, false, 15,
   "Количество полюсов", 296, UINT, 255, 1, false, 15,
   "Частота ШИМ (2-10 кГц)", 297, UINT, 255, 1, false, 15,
   "Характеристика U(f) №1: % напряжения от 380В в точке Fmin", 216, REAL, 255, 1, false, 16,
   "Характеристика U(f) №2: % напряжения от 380В в точке Fmin", 224, REAL, 255, 1, false, 16,
   "Характеристика U(f) №3: % напряжения от 380В в точке Fmin", 232, REAL, 255, 1, false, 16,
   "Характеристика U(f) №4: % напряжения от 380В в точке Fmin", 240, REAL, 255, 1, false, 16,
   "Характеристика U(f) №5: % напряжения от 380В в точке Fmin", 248, REAL, 255, 1, false, 16,
   "Характеристика U(f) №6: % напряжения от 380В в точке Fmin", 256, REAL, 255, 1, false, 16,
   "Характеристика U(f) №7: % напряжения от 380В в точке Fmin", 264, REAL, 255, 1, false, 16,
   "Характеристика U(f) №8: % напряжения от 380В в точке Fmin", 272, REAL, 255, 1, false, 16,
   "Характеристика U(f) №9: % напряжения от 380В в точке Fmin", 280, REAL, 255, 1, false, 16,
   "Характеристика U(f) №10: % напряжения от 380В в точке Fmin", 288, REAL, 255, 1, false, 16,
   "Характеристика U(f) №1: % напряжения от 380В в точке Fmid между Fmin и Fmax", 218, REAL, 255, 1, false, 17,
   "Характеристика U(f) №2: % напряжения от 380В в точке Fmid между Fmin и Fmax", 226, REAL, 255, 1, false, 17,
   "Характеристика U(f) №3: % напряжения от 380В в точке Fmid между Fmin и Fmax", 234, REAL, 255, 1, false, 17,
   "Характеристика U(f) №4: % напряжения от 380В в точке Fmid между Fmin и Fmax", 242, REAL, 255, 1, false, 17,
   "Характеристика U(f) №5: % напряжения от 380В в точке Fmid между Fmin и Fmax", 250, REAL, 255, 1, false, 17,
   "Характеристика U(f) №6: % напряжения от 380В в точке Fmid между Fmin и Fmax", 258, REAL, 255, 1, false, 17,
   "Характеристика U(f) №7: % напряжения от 380В в точке Fmid между Fmin и Fmax", 266, REAL, 255, 1, false, 17,
   "Характеристика U(f) №8: % напряжения от 380В в точке Fmid между Fmin и Fmax", 274, REAL, 255, 1, false, 17,
   "Характеристика U(f) №9: % напряжения от 380В в точке Fmid между Fmin и Fmax", 282, REAL, 255, 1, false, 17,
   "Характеристика U(f) №10: % напряжения от 380В в точке Fmid между Fmin и Fmax", 290, REAL, 255, 1, false, 17,
   "Характеристика U(f) №1: % напряжения от 380В в точке Fmax", 220, REAL, 255, 1, false, 18,
   "Характеристика U(f) №2: % напряжения от 380В в точке Fmax", 228, REAL, 255, 1, false, 18,
   "Характеристика U(f) №3: % напряжения от 380В в точке Fmax", 236, REAL, 255, 1, false, 18,
   "Характеристика U(f) №4: % напряжения от 380В в точке Fmax", 244, REAL, 255, 1, false, 18,
   "Характеристика U(f) №5: % напряжения от 380В в точке Fmax", 252, REAL, 255, 1, false, 18,
   "Характеристика U(f) №6: % напряжения от 380В в точке Fmax", 260, REAL, 255, 1, false, 18,
   "Характеристика U(f) №7: % напряжения от 380В в точке Fmax", 268, REAL, 255, 1, false, 18,
   "Характеристика U(f) №8: % напряжения от 380В в точке Fmax", 276, REAL, 255, 1, false, 18,
   "Характеристика U(f) №9: % напряжения от 380В в точке Fmax", 284, REAL, 255, 1, false, 18,
   "Характеристика U(f) №10: % напряжения от 380В в точке Fmax", 292, REAL, 255, 1, false, 18,
   "Характеристика U(f) №1: Fmid(Гц)", 222, REAL, 255, 1, false, 19,
   "Характеристика U(f) №2: Fmid(Гц)", 230, REAL, 255, 1, false, 19,
   "Характеристика U(f) №3: Fmid(Гц)", 238, REAL, 255, 1, false, 19,
   "Характеристика U(f) №4: Fmid(Гц)", 246, REAL, 255, 1, false, 19,
   "Характеристика U(f) №5: Fmid(Гц)", 254, REAL, 255, 1, false, 19,
   "Характеристика U(f) №6: Fmid(Гц)", 262, REAL, 255, 1, false, 19,
   "Характеристика U(f) №7: Fmid(Гц)", 270, REAL, 255, 1, false, 19,
   "Характеристика U(f) №8: Fmid(Гц)", 278, REAL, 255, 1, false, 19,
   "Характеристика U(f) №9: Fmid(Гц)", 286, REAL, 255, 1, false, 19,
   "Характеристика U(f) №10:Fmid(Гц)", 294, REAL, 255, 1, false, 19,
   "Контекст 1", 400, REAL, 255, 1, false, 20,
   "Контекст 2", 402, REAL, 255, 1, false, 20,
   "Контекст 3", 404, REAL, 255, 1, false, 20,
   "Контекст 4", 406, REAL, 255, 1, false, 20,
   "Контекст 5", 408, REAL, 255, 1, false, 20,
   "Контекст 6", 410, REAL, 255, 1, false, 20,
   "Контекст 7", 412, REAL, 255, 1, false, 20,
   "Контекст 8", 414, REAL, 255, 1, false, 20,
   "Контекст 9", 416, REAL, 255, 1, false, 20,
   "Контекст 10", 418, REAL, 255, 1, false, 20,
   "Контекст 1", 420, REAL, 255, 1, false, 21,
   "Контекст 2", 422, REAL, 255, 1, false, 21,
   "Контекст 3", 424, REAL, 255, 1, false, 21,
   "Контекст 4", 426, REAL, 255, 1, false, 21,
   "Контекст 5", 428, REAL, 255, 1, false, 21,
   "Контекст 6", 430, REAL, 255, 1, false, 21,
   "Контекст 7", 432, REAL, 255, 1, false, 21,
   "Контекст 8", 434, REAL, 255, 1, false, 21,
   "Контекст 9", 436, REAL, 255, 1, false, 21,
   "Контекст 10", 438, REAL, 255, 1, false, 21,
   "Контекст 1", 440, REAL, 255, 1, false, 22,
   "Контекст 2", 442, REAL, 255, 1, false, 22,
   "Контекст 3", 444, REAL, 255, 1, false, 22,
   "Контекст 4", 446, REAL, 255, 1, false, 22,
   "Контекст 5", 448, REAL, 255, 1, false, 22,
   "Контекст 6", 450, REAL, 255, 1, false, 22,
   "Контекст 7", 452, REAL, 255, 1, false, 22,
   "Контекст 8", 454, REAL, 255, 1, false, 22,
   "Контекст 9", 456, REAL, 255, 1, false, 22,
   "Контекст 10", 458, REAL, 255, 1, false, 22,
   "Контекст 1", 460, REAL, 255, 1, false, 23,
   "Контекст 2", 462, REAL, 255, 1, false, 23,
   "Контекст 3", 464, REAL, 255, 1, false, 23,
   "Контекст 4", 466, REAL, 255, 1, false, 23,
   "Контекст 5", 468, REAL, 255, 1, false, 23,
   "Контекст 6", 470, REAL, 255, 1, false, 23,
   "Контекст 7", 472, REAL, 255, 1, false, 23,
   "Контекст 8", 474, REAL, 255, 1, false, 23,
   "Контекст 9", 476, REAL, 255, 1, false, 23,
   "Контекст 10", 478, REAL, 255, 1, false, 23,
   "Контекст 1", 480, REAL, 255, 1, false, 24,
   "Контекст 2", 482, REAL, 255, 1, false, 24,
   "Контекст 3", 484, REAL, 255, 1, false, 24,
   "Контекст 4", 486, REAL, 255, 1, false, 24,
   "Контекст 5", 488, REAL, 255, 1, false, 24,
   "Контекст 6", 490, REAL, 255, 1, false, 24,
   "Контекст 7", 492, REAL, 255, 1, false, 24,
   "Контекст 8", 494, REAL, 255, 1, false, 24,
   "Контекст 9", 496, REAL, 255, 1, false, 24,
   "Контекст 10", 498, REAL, 255, 1, false, 24,
   "Контекст 1", 500, UINT, 255, 1, false, 25,
   "Контекст 2", 501, UINT, 255, 1, false, 25,
   "Контекст 3", 502, UINT, 255, 1, false, 25,
   "Контекст 4", 503, UINT, 255, 1, false, 25,
   "Контекст 5", 504, UINT, 255, 1, false, 25,
   "Контекст 6", 505, UINT, 255, 1, false, 25,
   "Контекст 7", 506, UINT, 255, 1, false, 25,
   "Контекст 8", 507, UINT, 255, 1, false, 25,
   "Контекст 9", 508, UINT, 255, 1, false, 25,
   "Контекст 10", 509, UINT, 255, 1, false, 25,
   "Контекст 1", 510, UINT, 255, 1, false, 26,
   "Контекст 2", 511, UINT, 255, 1, false, 26,
   "Контекст 3", 512, UINT, 255, 1, false, 26,
   "Контекст 4", 513, UINT, 255, 1, false, 26,
   "Контекст 5", 514, UINT, 255, 1, false, 26,
   "Контекст 6", 515, UINT, 255, 1, false, 26,
   "Контекст 7", 516, UINT, 255, 1, false, 26,
   "Контекст 8", 517, UINT, 255, 1, false, 26,
   "Контекст 9", 518, UINT, 255, 1, false, 26,
   "Контекст 10", 519, UINT, 255, 1, false, 26,
   "Источник контекста: 0-модбас, 1-ТС1", 520, UINT, 255, 1, false, 27,
   "Номер контекста при ТС1=0 (TC1 - источник контекста)", 521, UINT, 255, 1, false, 27,
   "Номер контекста при ТС1=1 (TC1 - источник контекста)", 522, UINT, 255, 1, false, 27,
   "Номер контекста, когда источник контекста - модбас", 523, UINT, 255, 1, false, 27,
   "Время перехода между контекстами(В/с)", 524, UINT, 255, 1, false, 27,
   "Насыщение ключей", 800, UINT, 255, 1, false, 28,
   "Перенапряжений", 803, UINT, 255, 1, false, 28,
   "Аварий мгновенных токов Ia", 804, UINT, 255, 1, false, 28,
   "Аварий мгновенных токов Ib", 805, UINT, 255, 1, false, 28,
   "Аварий мгновенных токов Ic", 806, UINT, 255, 1, false, 28,
   "Аварий действующего значения тока", 807, UINT, 255, 1, false, 28,
   "Аварий ЭТР", 808, UINT, 255, 1, false, 28,
   "Обрывов фазы A", 809, UINT, 255, 1, false, 28,
   "Обрывов фазы B", 810, UINT, 255, 1, false, 28,
   "Обрывов фазы C", 811, UINT, 255, 1, false, 28,
   "Дисбалансов тока", 812, UINT, 255, 1, false, 28,
   "Аварий температуры отсека конденсаторов", 813, UINT, 255, 1, false, 28,
   "Аварий температуры радиатора", 814, UINT, 255, 1, false, 28,
   "Низкого напряжения DC-шины", 815, UINT, 255, 1, false, 28,
   "Холостой ход и превышение частоты", 818, UINT, 255, 1, false, 28,
   "adc_pwm_err", 819, UINT, 255, 1, false, 28,
   "adc_energy_err", 820, UINT, 255, 1, false, 28,
   "Перезагрузок по Watchdog timer ", 832, UINT, 255, 1, false, 28,
   "Перезагрузка ЧРЭП", 833, UINT, 255, 1, false, 28,
   "Отвод №1", 900, UINT, 255, 1, false, 29,
   "Отвод №2", 901, UINT, 255, 1, false, 29,
   "Отвод №3", 902, UINT, 255, 1, false, 29,
   "Отвод №4", 903, UINT, 255, 1, false, 29,
   "Отвод №5", 904, UINT, 255, 1, false, 29,
   "Отвод №6", 905, UINT, 255, 1, false, 29,
   "Отвод №7", 906, UINT, 255, 1, false, 29,
   "Отвод №8", 907, UINT, 255, 1, false, 29,
   "Отвод №9", 908, UINT, 255, 1, false, 29,
   "Отвод №10", 909, UINT, 255, 1, false, 29,
   "Отвод №11", 910, UINT, 255, 1, false, 29,
   "Отвод №12", 911, UINT, 255, 1, false, 29,
   "Отвод №13", 912, UINT, 255, 1, false, 29,
   "Отвод №14", 913, UINT, 255, 1, false, 29,
   "Отвод №15", 914, UINT, 255, 1, false, 29,
   "Отвод №16", 915, UINT, 255, 1, false, 29,
   "Отвод №1", 916, UINT, 255, 1, false, 30,
   "Отвод №2", 917, UINT, 255, 1, false, 30,
   "Отвод №3", 918, UINT, 255, 1, false, 30,
   "Отвод №4", 919, UINT, 255, 1, false, 30,
   "Отвод №5", 920, UINT, 255, 1, false, 30,
   "Отвод №6", 921, UINT, 255, 1, false, 30,
   "Отвод №7", 922, UINT, 255, 1, false, 30,
   "Отвод №8", 923, UINT, 255, 1, false, 30,
   "Отвод №9", 924, UINT, 255, 1, false, 30,
   "Отвод №10", 925, UINT, 255, 1, false, 30,
   "Отвод №11", 926, UINT, 255, 1, false, 30,
   "Отвод №12", 927, UINT, 255, 1, false, 30,
   "Отвод №13", 928, UINT, 255, 1, false, 30,
   "Отвод №14", 929, UINT, 255, 1, false, 30,
   "Отвод №15", 930, UINT, 255, 1, false, 30,
   "Отвод №16", 931, UINT, 255, 1, false, 30,
   "Включение архивирования(>0)", 932, UINT, 255, 1, false, 31,
   "Включение формирования суммарного суточного замера по отводу(>0)", 933, UINT, 255, 1, false, 31,
   "Час формирования суммарного суточного замера по отводам", 934, UINT, 255, 1, false, 31,
   "Минута формирования суммарного суточного замера по отводам", 935, UINT, 255, 1, false, 31,
   "Секунда формирования суммарного суточного замера по отводам", 936, UINT, 255, 1, false, 31,
   "Смещение по времени формирования записей(+/-сек)", 937, INT, 255, 1, false, 31,
   "L1 горизонт(мм)", 11000, UINT, 255, 1, false, 32,
   "L2 вертикаль(мм)", 11001, UINT, 255, 1, false, 32,
   "L шатуна(мм)", 11002, UINT, 255, 1, false, 32,
   "Заднее плечо балансира(мм)", 11003, UINT, 255, 1, false, 32,
   "Переднее плечо балансира(мм)", 11004, UINT, 255, 1, false, 32,
   "Радиус кривошипа(мм)", 11005, UINT, 255, 1, false, 32,
   "Задержка снятия очередной динамогр(сек)", 11006, UINT, 255, 1, false, 32,
   "Тайм-аут сигнала оборота(сек)", 11007, UINT, 255, 1, false, 32,
   "Защита от дребезга сигнала оборота(циклы ШИМ)", 11008, UINT, 255, 1, false, 32,
   "Min период между сигналами оборота(мс)", 11009, UINT, 255, 1, false, 32,
   "Усреднение ТИТ3(циклы ШИМ)", 11010, UINT, 255, 1, false, 32,
   "Коэфф (k,y=k*x+b) пересчета кода ТИТ3 в силу", 11011, REAL, 255, 1, false, 32,
   "Постоянная (b,y=k*x+b) пересчета кода ТИТ3 в силу", 11013, REAL, 255, 1, false, 32,
   "Авария по минимальной нагрузке с динамографа", 11015, REAL, 255, 1, false, 33,
   "Авария по максимальной нагрузке с динамографа", 11017, REAL, 255, 1, false, 33,
   "Время удержания по аварии с динамографа(мс,0-выкл)", 11019, UINT, 255, 1, false, 33,
   "Max значение счетчика АПВ", 87, UINT, 255, 1, false, 33,
   "Время декрементирования счетчика АПВ(мин)", 88, UINT, 255, 1, false, 33,
   "Допустимый процент проскальзывания", 11046, UINT, 255, 1, false, 33,
   "Время автозапуска после аварии по усилию(мин)", 11040, UINT, 255, 1, false, 33,
   "Минимальная частота алгоритма динамографа", 11020, REAL, 255, 1, false, 34,
   "Стартовая частота алгоритма динамографа", 11022, REAL, 255, 1, false, 34,
   "Максимальная частота алгоритма динамографа", 11024, REAL, 255, 1, false, 34,
   "Мин нагрузка включения понижения частоты(или уставка П-регулятора)", 11026, REAL, 255, 1, false, 34,
   "Мин нагрузка отключения понижения частоты", 11028, REAL, 255, 1, false, 34,
   "Изменение частоты(Гц)", 11030, REAL, 255, 1, false, 34,
   "Перемещение точки регулирования наполненности насоса", 11032, REAL, 255, 1, false, 34,
   "Усилие точки регулирования наполненности насоса", 11034, REAL, 255, 1, false, 34,
   "Кол-во динамограмм для регулирования наполненности насоса(0-откл)", 11036, UINT, 255, 1, false, 34,
   "Включение работы алгоритма:0-выкл,1-вкл,2-режим тестовой динамограммы", 11037, UINT, 255, 1, false, 34,
   "Коэффициент пропорциональности ПИД регулятора(0-выкл)", 11038, REAL, 255, 1, false, 34,
   "Тестовая динамограмма(квадрат)-минимальное перемещение", 11041, UINT, 255, 1, false, 34,
   "Тестовая динамограмма(квадрат)-максимальное перемещение", 11042, UINT, 255, 1, false, 34,
   "Тестовая динамограмма(квадрат)-минимальная нагрузка", 11043, UINT, 255, 1, false, 34,
   "Тестовая динамограмма(квадрат)-максимальная нагрузка", 11044, UINT, 255, 1, false, 34,
   "Количество отсчетов ШИМ тестовой динамограммы", 11045, UINT, 255, 1, false, 34,
   "Modbus адрес", 0, UINT, 255, 1, false, 35
};

const TParamItem ParamItem_1[MAX_PARAM_ITEM_1] = {
   "Сумма действующих значений фазных токов(А)", 600, REAL, 255, 1, false, 0,
   "Действующее значение тока Ia(A)", 602, REAL, 255, 1, false, 0,
   "Действующее значение тока Ib(А)", 604, REAL, 255, 1, false, 0,
   "Действующее значение тока Iс(А)", 606, REAL, 255, 1, false, 0,
   "Среднее значение действующих фазных напряжений(В) ", 608, REAL, 255, 1, false, 1,
   "Суммарная активная мощность(Вт)", 616, REAL, 255, 1, false, 2,
   "Активная мощность фазы А(Вт)", 618, REAL, 255, 1, false, 2,
   "Активная мощность фазы B(Вт)", 620, REAL, 255, 1, false, 2,
   "Активная мощность фазы C(Вт)", 622, REAL, 255, 1, false, 2,
   "Суммарная реактивная мощность(Вт)", 624, REAL, 255, 1, false, 2,
   "Реактивная мощность фазы A(Вт)", 626, REAL, 255, 1, false, 2,
   "Реактивная мощность фазы B(Вт)", 628, REAL, 255, 1, false, 2,
   "Реактивная мощность фазы C(Вт)", 630, REAL, 255, 1, false, 2,
   "Суммарная полная мощность(Вт)", 632, REAL, 255, 1, false, 2,
   "Полная мощность фазы A(Вт)", 634, REAL, 255, 1, false, 2,
   "Полная мощность фазы B(Вт)", 636, REAL, 255, 1, false, 2,
   "Полная мощность фазы C(Вт)", 638, REAL, 255, 1, false, 2,
   "Средний cosPhi", 640, REAL, 255, 1, false, 3,
   "cosPhi фазы A", 642, REAL, 255, 1, false, 3,
   "cosPhi фазы B", 644, REAL, 255, 1, false, 3,
   "cosPhi фазы C", 646, REAL, 255, 1, false, 3,
   "Среднее значение напряжения DC-шины(В)", 648, REAL, 255, 1, false, 1,
   "Номинальный момент(Н*м)", 650, REAL, 255, 1, false, 4,
   "Текущие обороты в минуту(с учетом скольжения)", 640, REAL, 255, 1, false, 4,
   "Текущий момент(Н*м)", 654, REAL, 255, 1, false, 4,
   "Процент от ном момента", 656, REAL, 255, 1, false, 4,
   "Температура блока конденсаторов(0C)", 658, INT, 255, 1, false, 5,
   "Температура радиатора(0С)", 659, INT, 255, 1, false, 5,
   "Аварийное слово-состояние №1", 660, UINT, 255, 1, false, 6,
   "Аварийное слово-состояние №2", 661, UINT, 255, 1, false, 6,
   "Мгновенная текущая выходная частота(x100)(Гц)", 662, UINT, 255, 1, false, 7,
   "Мгновенное напряжение на DC-шине(В)", 663, UINT, 255, 1, false, 1,
   "Max за период напряжение на DC-шине(В)", 664, UINT, 255, 1, false, 1,
   "Min за период напряжение на DC-шине(В)", 665, UINT, 255, 1, false, 1,
   "Пульсация напряжения DC-шины за период(В)", 666, INT, 255, 1, false, 1,
   "Максимальный мгновенный действующий фазный ток за период(А)", 667, UINT, 255, 1, false, 0,
   "Минимальный мгновенный действующий фазный ток за период(А)", 668, UINT, 255, 1, false, 0,
   "Пульсации мгновенного действующего фазного тока за период(А)", 669, INT, 255, 1, false, 0,
   "Температура внешнего датчика(0С)", 670, INT, 255, 1, false, 5,
   "Заданная выходная частота (x100)(Гц)", 671, UINT, 255, 1, false, 7,
   "Максимальный мгновенный фазный ток во время запуска двигателя(А)", 672, UINT, 255, 1, false, 0,
   "Мгновенное значение ТИТ1(0-4095)", 673, UINT, 255, 1, false, 8,
   "Мгновенное значение ТИТ2(0-4095)", 674, UINT, 255, 1, false, 8,
   "Мгновенное значение ТИТ3(0-4095)", 675, UINT, 255, 1, false, 8,
   "Мгновенное значение ТИТ4(0-4095)", 676, UINT, 255, 1, false, 8,
   "Размах 100Гц гармоники DC-шины(В)", 677, UINT, 255, 1, false, 1,
   "Текущее состояние ТС( бит0-ТС1 бит14-ТС15)", 678, UINT, 255, 1, false, 8,
   "Текущее состояние ТУ( бит0-ТУ1 бит3-ТУ4)", 679, UINT, 255, 1, false, 8,
   "Состояние динамогр(1-задержка,2-ожидание первого сигнала,3-второго)", 680, UINT, 255, 1, false, 6,
   "Код ошибки динамографа", 681, UINT, 255, 1, false, 6,
   "Текущий коэфф передачи двигатель/кривошип", 682, REAL, 255, 1, false, 6,
   "Изменение частоты алгоритма динамографа", 684, REAL, 255, 1, false, 6,
   "Текущее усилие на штанге", 686, REAL, 255, 1, false, 6,
   "Счетчик пакетов с неверной контрольной суммой", 704, UINT, 255, 1, false, 9,
   "Счетчик пакетов с неверной контрольной суммой", 700, UINT, 255, 1, false, 9,
   "Счетчик прерываний ошибки", 705, UINT, 255, 1, false, 9,
   "Счетчик прерываний ошибки", 701, UINT, 255, 1, false, 9,
   "Счетчик принятых по интервалу тишины пакетов", 706, UINT, 255, 1, false, 9,
   "Счетчик принятых по интервалу тишины пакетов", 702, UINT, 255, 1, false, 9,
   "Счетчик переданных пакетов", 707, UINT, 255, 1, false, 9,
   "Счетчик переданных пакетов", 703, UINT, 255, 1, false, 9,
   "Датчики температуры Кол-во ресетов во время работы ", 708, UINT, 255, 1, false, 10,
   "Датчики температуры Кол-во ошибок при инициализации", 709, UINT, 255, 1, false, 10,
   "Датчики температуры Кол-во ошибок контрольной суммы", 710, UINT, 255, 1, false, 10,
   "Датчики температуры Счетчик успешных попыток чтения", 711, UINT, 255, 1, false, 10,
   "FRAM Кол-во ошибок чтения", 712, UINT, 255, 1, false, 10,
   "FRAM Кол-во ошибок записи", 713, UINT, 255, 1, false, 10,
   "чтения температуры(мс)", 714, UINT, 255, 1, false, 11,
   "чтения времени(мс)", 715, UINT, 255, 1, false, 11,
   "вычисления энергетических параметров(мс)", 716, UINT, 255, 1, false, 11,
   "matlab-задачи(мс)", 717, UINT, 255, 1, false, 11,
   "modBus-задачи(мс)", 718, UINT, 255, 1, false, 11,
   "Кол-во ошибок совместной работы ШИМ и АЦП", 719, UINT, 255, 1, false, 10,
   "Кол-во ошибок вычисления энергетических параметров за период", 720, UINT, 255, 1, false, 10,
   "Вычисленный ток с учетом частоты(А)", 721, UINT, 255, 1, false, 12,
   "Ток уставки из I^2*T(А)", 722, UINT, 255, 1, false, 12,
   "Порог срабатывания защиты I^2*T деленный на 100 ", 723, UINT, 255, 1, false, 12,
   "Процент текущего счетчика ЭТР относительно срабатывания защиты", 724, UINT, 255, 1, false, 12,
   "по току", 735, UINT, 255, 1, false, 13,
   "по перекосу тока", 736, UINT, 255, 1, false, 13,
   "по перенапряжению", 737, UINT, 255, 1, false, 13,
   "по холстому ходу и превышению частоты ", 738, UINT, 255, 1, false, 13,
   "по ЭТР", 739, UINT, 255, 1, false, 13,
   "по низкому напряжению", 740, UINT, 255, 1, false, 13,
   "по температуре", 741, UINT, 255, 1, false, 13,
   "Текущий счетчик АПС", 742, UINT, 255, 1, false, 13,
   "WiFi Счетчик прерываний ошибки", 743, UINT, 255, 1, false, 10,
   "WiFi Счетчик принятых пакетов", 744, UINT, 255, 1, false, 10,
   "WiFi Счетчик переданных пакетов", 745, UINT, 255, 1, false, 10,
   "БВИ(мс)", 746, UINT, 255, 1, false, 11,
   "счетчика активной мощности(мс)", 747, UINT, 255, 1, false, 11,
   "ТИИ(мс)", 736, UINT, 255, 1, false, 11,
   "АПС(мс)", 749, UINT, 255, 1, false, 11,
   "WIFI(мс)", 750, UINT, 255, 1, false, 11,
   "расчета динамограммы(мс)", 751, UINT, 255, 1, false, 11,
   "по динамографу", 752, UINT, 255, 1, false, 13,
   "ПротоколСобытий текущийИндекс в контроллере", 999, UINT, 255, 1, false, 14,
   "АрхивТИИ текущий Индекс в Контроллере", 3999, UINT, 255, 1, false, 14,
   "Dyn", 20000, UINT, 255, 427, false, 15,
   "Максимальное усилие(кг)", 32672, UINT, 255, 1, false, 16,
   "Минимальное усилие(кг)", 32673, UINT, 255, 1, false, 16,
   "Длина качка(мм)", 32674, UINT, 255, 1, false, 16,
   "Период качка(сек*100)", 32675, UINT, 255, 1, false, 16,
   "Wat", 12000, INT, 2, 200, false, 17,
   "Wat", 12200, INT, 255, 200, false, 18,
   "ВерсияПО", 10000, STR, 255, 40, false, 19
   
  };
*/

const char AnswerOK[] = "HTTP/1.0 200 OK\r\n"
                        "Content-Type: text/plain; charset=windows-1251\r\n";

const char AnswerMain[] = "<html>\r\n"
                          "<frameset rows=\"50,*\">\r\n"
                          "<frame src=\"mainmenu.html\">\r\n"  
                          "<frameset cols=\"300,*\">\r\n"
                          "<frame src=\"menu.html\" name=\"a\">\r\n"
                          "<frame src=\"0\" name=\"b\">\r\n"
                          "</frameset>\r\n"
                          "</html>\r\n";

const char AnswerMainMenu[] = "<html>\r\n"
                              "<body link=\"white\" alink=\"yellow\" vlink=\"white\" style=\"background: #0066FF\">\r\n"
                              //"<font size=\"-2\">\r\n"  
                              "<a href=\"menu.html\" target=\"a\">Конфигурация</a>&nbsp;&nbsp;&nbsp;&nbsp;&nbsp;&nbsp;"
                              "<a href=\"menu1.html\" target=\"a\">Текущие параметры</a>&nbsp;&nbsp;&nbsp;&nbsp;&nbsp;&nbsp;"
                              "<a href=\"menuarhive.html\" target=\"a\">Архивы</a>\r\n"  
                              //"</font>\r\n"
                              "</body>\r\n"
                              "</html>\r\n";

const char AnswerGraph_1[] = "<html>\r\n"
                             "<body>\r\n"
                             "<canvas id='example'>Обновите браузер</canvas>\r\n"
                             "<script>\r\n"
                             "var example=document.getElementById(\"example\"),\r\n"
			     "ctx=example.getContext('2d');\r\n"
                             "example.width=window.innerWidth;\r\n"
                             "example.height=window.innerHeight;\r\n"
                             "ctx.strokeRect(15, 15, 266, 266);\r\n"
                             "ctx.strokeRect(18, 18, 260, 260);\r\n"
                             "ctx.fillRect(20, 20, 256, 256);\r\n"
                             "for (i = 0; i < 8; i += 2)\r\n"
                             "for (j = 0; j < 8; j += 2) {\r\n"
                             "ctx.clearRect(20 + i * 32, 20 + j * 32, 32, 32);"
                             "ctx.clearRect(20 + (i + 1) * 32, 20 + (j + 1) * 32, 32, 32);"
                             "}\r\n"
                             "</script>\r\n"
                             "</body>\r\n"
                             "</html>\r\n";

const char AnswerDyn_1[] = "<html>\r\n"
                             "<body>\r\n"
                             "<canvas id='example'>Обновите браузер</canvas>\r\n"
                             "<script>\r\n"
                             "var k, kX, kY;\r\n"
                             "var maxY;\r\n" 
                             "var minY;\r\n"  
                             "var maxX;\r\n"  
                             "var minX;\r\n"   
                             "var s=20;\r\n"  
                             "var example=document.getElementById(\"example\"),\r\n"
			     "ctx=example.getContext('2d');\r\n"
                             "example.width=window.document.documentElement.clientWidth-50;\r\n"
                             "example.height=window.document.documentElement.clientHeight-50;\r\n";                                 
                             //"example.width=window.innerWidth;\r\n"
                             //"example.height=window.innerHeight;\r\n";
                             		     
                               
const char AnswerDyn_2[] = "</script>\r\n"
	                   "</body>\r\n"
                           "</html>\r\n";

const char AnswerError[] = 
        "HTTP/1.0 404 Not Found\r\n"
        "Content-Type: text/html; charset=windows-1251\r\n"
        "Server: ATmega16\r\n"
        "\r\n"
        "<pre>Page not found\r\n\r\n"
        "<a href='/'>Home page</a></pre>\r\n";

const char AnswerError500[] = 
        "HTTP/1.0 500 Internal server error\r\n"
        "Content-Type: text/html; charset=windows-1251\r\n"
        "Server: ATmega16\r\n"
        "\r\n"
        "<pre>Page not found\r\n\r\n"
        "<a href='/'>Home page</a></pre>\r\n";

const char AnswerHead[] = "HTTP/1.0 200 OK\r\n"
                          "Content-Type: text/html; charset=windows-1251\r\n"
                          "Content-Length: ";

const char MenuArhive[] = "HTTP/1.0 200 OK\r\n"
                          "Content-Type: text/html; charset=windows-1251\r\n"
                          "Content-Length: ";
//***************************
const char html_text_black[] = "<html>\r\n <body text = \"#000000\">\r\n";
const char html_text_blue[] = "<html>\r\n <body text = \"#0000ff\">\r\n";
const char html_method[] = "<form action='/' method='POST'>\r\n<br>\r\n";
const char html_method_get_1[] = "<form action='/";
const char html_method_get_2[] = "' method='GET'>\r\n<br>\r\n";

const char html_font_color_1[] = "<font color=\"#ff0000\">Раздел: ";  
const char html_font_color_2[] = "</font>\r\n<br>\r\n";//<font size=\"-2\">\r\n" ;

const char html_input_type_1[] = "\r\n<input type='text' name='";
const char html_input_type_2[] = "' value='"; //"' size='10' value='";
const char html_input_type_3[] = "'>\r\n<br>\r\n";

const char html_text_1[] = "<p>";
const char html_text_2[] = ": ";
const char html_text_3[] = "</p>\r\n";

const char html_end[] = "</font>\r\n<input type='submit' value='Запись'>\r\n</form>\r\n</body>\r\n </html>\r\n";
const char html_end_1[] = "</font>\r\n<input type='submit' value='Чтение'>\r\n</form>\r\n</body>\r\n </html>\r\n";
const char html_end_2[] = "</font>\r\n</body>\r\n </html>\r\n";


const char AT_CIPSEND_1[] = "AT+CIPSEND=";    
const char AT_CIPSEND_2[] = ",";   
const char AT_CIPSEND_3[] = "\r\n"; 

const char html_menu_begin[] = "<html>\r\n <body link=\"white\" alink=\"yellow\" vlink=\"white\" style=\"background: #0066FF\">\r\n";
const char html_menu_1[] = "<li><a href=\"";
const char html_menu_2[] = "\" target=\"b\">";
const char html_menu_3[] = "</a></li>\r\n";
const char html_menu_end[] = "</body>\r\n</html>\r\n";

const char FloatDot[] = "."; 
const char html_br[] = "<br>"; 

//********** Расшифровка аварий

/*
const char AVAR_1[] = "АВАРИЯ.Перегруз по мгновенному току";
const char AVAR_2[] = "АВАРИЯ.Перегруз по действ. значению тока";
const char AVAR_3[] = "АВАРИЯ.Насыщение силовых ключей";
const char AVAR_4[] = "АВАРИЯ.Перенапряжение DC-шины"; 
const char AVAR_5[] = "АВАРИЯ.Перегрузка двигателя по ЭТР" ;
const char AVAR_6[] = "АВАРИЯ.Обрыв фазы";
const char AVAR_7[] = "АВАРИЯ.Перекос тока"; 
const char AVAR_8[] = "АВАРИЯ.Датчик температуры" ;
const char AVAR_9[] = "АВАРИЯ.Низкое напряжение DC-шины";
const char AVAR_10[] = "АВАРИЯ.Холостой ход";
const char AVAR_11[] = "АВАРИЯ.Превышение вых. частоты в генер-м режиме";
const char AVAR_12[] = "Включение питания";
const char AVAR_13[] = "Выключение питания"; 
const char AVAR_14[] = "Пуск двигателя: ";
const char AVAR_15[] = "Останов двигателя: ";
const char AVAR_16[] = "Сброс ошибок: " ;
const char AVAR_17[] = "Изменение режима работы до: ";
const char AVAR_17_1[] = " после: ";
const char AVAR_18[] = "АВАРИЯ.Код ошибки инициализации: ";
const char AVAR_19[] = "АВАР.Перезагрузка по сторожевому таймеру: " ;
const char AVAR_20[] = "АВАР.УдержаниеНизкогоНапряженияDC-шины.Размах100Гц/10(В): " ;
const char AVAR_21[] = "АВАР.ФиксацияНизкогоНапряженияDC-шины.Размах100Гц/10(В): " ;
const char AVAR_22[] = "АВАР.УдержаниеНеполнофазногоРежима.Размах100Гц/10(В): " ;
const char AVAR_23[] = "АВАР.ФиксацияНеполнофазногоРежима.Размах100Гц/10(В): " ;
const char AVAR_24[] = "АВАР.ОграничениеПусковогоТока.МгновенныйТок A B C(А): " ;
const char AVAR_25[] = "АВАР.ДатчикНагрузки: ";
const char AVAR_100[] = "Отвод: ";
const char AVAR_NAN[] = "Неизвестный код архива" ;

const char AVAR_CHREP[] = "ЧРЭП";
const char AVAR_KP[] = "КП";
const char AVAR_MANUAL[] = "Ручной";
const char AVAR_CHREP_MODBUS[] = "ЧРЭП, модбас(без перезагрузки)";
const char AVAR_TC[] = "TC1";
const char AVAR_MODBUS[] = "МОДБАС";
const char AVAR_WORD_1[] = " слово №1: ";
const char AVAR_WORD_2[] = " слово №2: ";
const char AVAR_PO[] = "ошибка ПО";
const char AVAR_PWM_ERR[] = " adcpwmERR: ";
const char AVAR_ENERGY_ERR[] = " adcenergyERR: ";

// Расшифровка параметров аварий
const char AVAR_1_4[] = "  - Мгновенный ток по фазе А, А: ";
const char AVAR_1_5[] = "  - Мгновенный ток по фазе B, А: ";
const char AVAR_1_6[] = "  - Мгновенный ток по фазе C, А: ";
const char AVAR_1_7[] = "  - Мгновенное среднее действующее значение тока, А: ";
const char AVAR_1_8[] = "  - Мгновенное значение напряжения на DC-шине, В: ";
const char AVAR_1_9[] = "  - Мгновенная активная мощность, кВт: ";

const char AVAR_4_5[] = "  - Установленная выходная частота, Гц: ";
const char AVAR_4_6[] = "  - Текущая выходная частота, Гц: ";

const char AVAR_5_4[] = "  - Температура конденсатора, С: ";
const char AVAR_5_5[] = "  - Температура радиатора, С: ";
const char AVAR_5_6[] = "  - Температура внешнего датчика, С: ";

const char AVAR_6_4[] = "  - Действующее значение тока по фазе А, А: ";
const char AVAR_6_5[] = "  - Действующее значение тока по фазе B, А: ";
const char AVAR_6_6[] = "  - Действующее значение тока по фазе C, А: ";
const char AVAR_6_9[] = "  - Размах мгн-го действ. тока за период вых. частоты, А: ";

const char AVAR_9_9[] = "  - Действующее значение напряжения на двигателе, В: ";

const char AVAR_10_8[] = "  - Действующее значение напряжения на DC-шине, В: ";
const char AVAR_10_9[] = "  - Действующее значение активной мощности, кВт: ";

const char AVAR_20_4[] = "  - Q10, размах 100 Гц-гармоники, Гц: ";
const char AVAR_20_5[] = "  - Текущая выходная частота, Гц: ";
const char AVAR_20_6[] = "  - Размах мгновенного напряжения DC-шины, В: ";
const char AVAR_20_7[] = "  - Размах мгновенного действующего тока, А: ";
const char AVAR_20_8[] = "  - Мгновенное значение напряжения на DC-шине, В: ";
const char AVAR_20_9[] = "  - Действующее значение активной мощности, кВт: ";

const char AVAR_25_4[] = "  - Усилие на динамометре: ";

const char AVAR_100_4[] = "  - Интервал замера, мин: ";
const char AVAR_100_6[] = "  - Замер: ";

const char AVAR_116_6[] = "  - Расход электроэнергии КвтЧас: ";
const char AVAR_110_6[] = "  - Количество качаний: ";

*/

int PrevID;
char Flag_Wait_OK = 0;
char CountSecWaitOK;

char sAnswerID[15];
char sFindChanel[5];
char sDeleteItemOfChanel[10];


char ValStr[MAX_COUNT_WORD * 2];

char sID[10];

char strFloat1[10];
char strFloat2[10];

char CurrentMenu;
//Количество пакетов если html > 2048
char StepCount;

// прочитанные данные с устройства
uint16_t ValData[MAX_COUNT_WORD];

TFloat val_Float;
TInteger val_Integer;
TDWord val_DWord;
// Дата и время
char u_2_sec;
char u_2_min;
char u_2_hor; 
char u_2_month;
char u_2_date;
char u_2_year;


TParamItem PItem;
//TCharToParamItem CharToParamItem;

// возвращает адрес следующего элемента, после копирования
unsigned char *copy_P(char *dest,const char *src)
        //unsigned char *copy_P(unsigned char *dest,char const *src)
{
    //for (ii=0;ii<sizeof(webif_200_header)-1;ii++) *dest++=*src++;
    while(*src) *dest++=*src++;
    *dest = 0;
    return(dest);
}

int CurrPos; // Текущаая позиция для функции Pos в CheskWordInString
unsigned int LengthInBuf;
// функция возвращает позицию первого вхождение подстроки substr в строке str начиная с позиции idx
// возвращает -1 если не найдено
int Pos(char *substr, char *str, int idx)
{
    int i, j, result = -1;
    enum bool flOK;
    int len_substr = strlen(substr); //длина подстроки без 0 символа
    int len_str = strlen(str); //длина строки
    
    for (i = idx; i <= len_str - len_substr; i++)
    {
        flOK = true;
        for (j = 0; j < len_substr; j++)
        {
            if (substr[j] != str[i + j])
            {
                flOK = false;
                break;
            }
        }
        if (flOK)
        {
            result = i;
            break;
        }
    }
    return result;
}

float ExtractFloat(char *aString, int aIndex, int aSize)
{
    int i, IntPart;
    long int koef;
    float result;
    
    koef = 1;
    result = 0;
    IntPart = 0;
    
    if (aIndex < 0)
    {
        for (i = aSize - 1; i >= 0; i--)
        {
            result = result + (aString[i] - 0x30) * koef;
            koef = koef * 10;
        }
        return result;      
    }
    
    for (i = aIndex - 1; i >=0; i--)
    {
        IntPart = IntPart + (aString[i] - 0x30) * koef;
        koef = koef * 10;
    };

    koef = 1;

    for (i = aSize - 1; i > aIndex; i--)
    {
        result = result + (aString[i] - 0x30) * koef;
        koef = koef * 10;
    };

    result = IntPart + result/koef;
    return result;
}

float StrToFloat(char *aString)
{
    int idx;
    int sz;
    float result;

    sz = strlen(aString);

    if (sz < 1)
        return 0;
    idx = Pos(",", aString, 0);
    if (idx < 0)
    {
        idx = Pos(".", aString, 0);
        if (idx < 0)
        {
            //целое значение
            result = ExtractFloat(aString, idx, sz);
        }
        else
        {
            //разделитель точка
            result = ExtractFloat(aString, idx, sz);
        }
    }
    else
    {
        //разделитель запятая
        result = ExtractFloat(aString, idx, sz);
    }
    return result;
}

char FloatToStr(float aValue, char *aString)
{
    int i, j;
    long int i1;
    float f;
    unsigned long int i2;
    int sz;

    if (isnan(aValue))
    {
        return 0;
    } 
    else 
      if (isinf(aValue)) 
      {
         return 0;
      };
      
    for (i = 0; i < 10; i++)
        strFloat2[i] = 0;

    i1 = aValue;
    f = aValue - i1;
    i2 = 1;
    for (i = 0; i < 6; i++)
    {
        i2 = f * 10;
        if (f * 10 - i2 == 0)
            break;
        f = f * 10;
    };

    sprintf(strFloat1,"%lu", i2);
    sz = strlen(strFloat1);
    sz = i - sz;
    if (sz > 0)
    {
        for (j = 0; j < sz; j++)
            strFloat2[j] = 0x30;
        sprintf(aString,"%ld.%s%lu", i1, strFloat2, i2);
    }
    else
        sprintf(aString,"%ld.%lu", i1, i2);
    
    return 1;
};


enum bool CheskWordInString(char *substr, char *str)
{
    int i;

    i = Pos(substr, str, CurrPos);
    
    if (i >= 0)
    {
        CurrPos = i;
        return  true;
    }
    else
        return false;
};

int StrToInt(char *str)
{
    int i, n, result, k, d;

    result = 0;
    k = 1;
    n = strlen(str);

    if (n < 1)
        return -1;

    for (i = n - 1; i >= 0; i--)
    {
        if (str[i] == '?')
          continue;
        d = str[i] - 0x30;
        if ((d >= 0) && (d <= 9))
        {
            result = result + (str[i] - 0x30) * k;
            k = k * 10;
        }
        else
            return -1;
    }

    return result;
    
}

int GetAnswerID(char *str)
{
    int i, b, e, result;
    

    for (i = 0; i < 20; i++)
        sAnswerID[i] = 0;
    
    b = Pos("GET /", str, CurrPos) + 5;
    e = Pos(" HTTP/", str, CurrPos);
    
    if (b == e)
        return PAGE_MAIN;
    
    for (i = 0; i < e - b; i++)
        sAnswerID[i] = str[i + b];

    if (strcmp(sAnswerID, "mainmenu.html") == 0)
        return PAGE_MAIN_MENU;
    
    if (strcmp(sAnswerID, "menu.html") == 0)
        return PAGE_MENU;

    if (strcmp(sAnswerID, "menu1.html") == 0)
        return PAGE_MENU_1;
    
    if (strcmp(sAnswerID, "menuarhive.html") == 0)
        return PAGE_MENU_ARHIVE;
    
    if (strcmp(sAnswerID, "favicon.ico") == 0)
        return PAGE_ERROR;
    
    result = StrToInt(sAnswerID); //atoi(sAnswerID);
    
    if (( result > MAX_ARRSECTION - 1) || (result < 0))
        return PAGE_ERROR;
    
    PrevID = result;
    return result;
}

// Возвращает номер канала найденный после IPD+
int FindChanel(char *str)
{
    int i, j;
    enum bool flOK = true;
    
    for (i = 0; i < 5; i++)
        sFindChanel[i] = 0;
    
    i = Pos("+IPD,", str, CurrPos) + 5; // 4 - длина IPD+
    j = 0;
    
    while  (str[i] != ',')
    {
        sFindChanel[j] = str[i];
        j++;
        i++;
        if (i > strlen(str))
        {
            flOK = false;
            break;

        };
    };
    
    if (flOK)
        return  atoi(sFindChanel);
    else
        return -1;
};

void DeleteHtmlItem(int aIndex)
{
    int i;
    if (CountItemInHtmlList == 0)
        return;
    if (aIndex > MAX_HTML_ITEM - 1)
        return;
    for (i = aIndex; i <= MAX_HTML_ITEM - 2; i++)
        htmlList[i] = htmlList[i + 1];
    CountItemInHtmlList--;
}

void DeleteItemOfChanel(char * str)
{
    int i, j, chnl;
    

    if (CountItemInHtmlList == 0)
        return;

    j = Pos(",CLOSED", str, 0);

    //memcpy(sDeleteItemOfChanel, str + (j - 1), 1);
    //chnl = atoi(sDeleteItemOfChanel);
    chnl = str[j - 1] - 0x30;
    i = 0;
    while (true)
    {
        if (htmlList[i].Chanel == chnl)
            DeleteHtmlItem(i);
        else
            i++;

        if (i >= CountItemInHtmlList)
            break;
    };
};

void AddHtmlItemInList(ThtmlItem aItem)
{
    if (CountItemInHtmlList >= MAX_HTML_ITEM - 1)
        return;
    CountItemInHtmlList++;
    htmlList[CountItemInHtmlList - 1] = aItem;
};

void ExtractDataFromString(char *inBuf, unsigned int aSize)
{
    int i, idx1, idx2;
    
    while (true)
    {
        idx1 = Pos(NAME_POST, inBuf, CurrPos);
        if (idx1 < 0)
            break;
        //Очищаем массивы для номера параметра и значения
        for (i = 0; i < 10; i++)
        {
            sID[i] = 0;
            ValStr[i] = 0;
        };
        CurrPos = idx1;
        idx1 = idx1 + strlen(NAME_POST); // позиция первой цифры в конструкции rinatXXX
        idx2 = Pos("=", inBuf, CurrPos);
        // Получаем номер параметра
        for(i = idx1; i < idx2; i++)
            sID[i - idx1] = inBuf[i];

        idx1 = idx2 + 1; // в idx1 позиция за символом '='
        idx2 = Pos("&", inBuf, CurrPos);

        if (idx2 < 0)
            idx2 = aSize;
        // Получаем значение параметра
        for(i = idx1; i < idx2; i++)
            ValStr[i - idx1] = inBuf[i];
        //преобразуем индекс в число
        i = atoi(sID);
        CurrPos = idx2;
        // Получаем сруктуру параметра по индексу
        PItem = GetParam(&ParamItem[i].Name[0]);
        WriteDataToMemory(ValStr);
        
        if (idx2 == aSize)
            break;
    };
};
// inBuf - входной\выходной буфер. *aSize - размер выходного пакета
char CreateHtmlItem(char *inBuf, unsigned int *aSize, unsigned int aSizeIn)
{
    int id, i, sz;
    int chnl;
    ThtmlItem htmlItem;
    char result;
    
    result = NOT_WRITE_PORT;

    if (aSizeIn > 0)
    {

        CurrPos = 0;
        LengthInBuf = aSizeIn;
        
        if (CountItemInHtmlList > 0)
        {
            switch (htmlList[0].Step)
            {
            case STEP_WAIT_SEND_OK:
                if (CheskWordInString("SEND OK", inBuf))
                {
                    sz = strlen(HTMLString);
                    if ( sz > MAX_SIZE_ONE_HTML_PACKET)
                    {
                      StepCount++;
                      for (i = 0; i < sz - MAX_SIZE_ONE_HTML_PACKET; i++)
                        HTMLString[i] = HTMLString[i + MAX_SIZE_ONE_HTML_PACKET];
                      sz = sz - MAX_SIZE_ONE_HTML_PACKET; 
                      for (i = sz; i < MAX_SIZE_HTML_PACKET; i++)
                        HTMLString[i] = 0;
                      
                      if (DoSendAT(htmlList[0].Chanel, htmlList[0].ID, inBuf, aSize) == 0)
                          htmlList[0].ID = PAGE_ERROR_500;
                      htmlList[0].Step = STEP_WAIT_OK;
                      Flag_Wait_OK = 1;
                      CountSecWaitOK = 0;
                      result = WRITE_PORT;
                      break;                      
                    }
                    else
                    {
                    DeleteHtmlItem(0);
                    
                    break;
                    }
                }
                else
                    CountItemInHtmlList = 0;
                break;
           case STEP_WAIT_OK:
                if (CheskWordInString("OK\r\n>", inBuf))
                {
                    Flag_Wait_OK = 0;
                    htmlList[0].Step = STEP_HTML;
                    DoHTML(htmlList[0].ID, inBuf, aSize);
                    htmlList[0].Step = STEP_WAIT_SEND_OK;
                    result = WRITE_PORT;
                    return result;
                }
                else
                    CountItemInHtmlList = 0;
                break;
            };
        };
        
        //CurrPos = 0;
        //if (CheskWordInString("CLOSED", inBuf))
        //    DeleteItemOfChanel(inBuf);
        CurrPos = 0;


        while (true)
        {
            if (CheskWordInString("+IPD,", inBuf))
            {
                
                chnl = FindChanel(inBuf);

                if (CheskWordInString("GET /", inBuf))
                {
                    id = GetAnswerID(inBuf);
                    ColorHtmlText = 0;
                    if (id >=0)
                    {
                        htmlItem.Chanel = chnl;
                        htmlItem.ID = id;
                        htmlItem.Step = STEP_CIPSEND;
                        AddHtmlItemInList(htmlItem);

                    };
                }
                else
                {

                    if (CheskWordInString("POST /", inBuf))
                    {
                        id = PrevID;
                        ColorHtmlText = 1;
                        ExtractDataFromString(inBuf, aSizeIn); //Надо дописать
                        if (id >= 0)
                        {
                            htmlItem.Chanel = chnl;
                            htmlItem.ID = id;
                            htmlItem.Step = STEP_CIPSEND;
                            AddHtmlItemInList(htmlItem);

                        };

                    };
                };
            }
            else
                break;

        };

        if (CountItemInHtmlList == 0)
            return result;

        switch (htmlList[0].Step)
        {
        case STEP_CIPSEND:
            ClearHTMLString();
            StepCount = 0;
            if (DoSendAT(htmlList[0].Chanel, htmlList[0].ID, inBuf, aSize) == 0)
              htmlList[0].ID = PAGE_ERROR_500;
            htmlList[0].Step = STEP_WAIT_OK;
            Flag_Wait_OK = 1;
            CountSecWaitOK = 0;
            result = WRITE_PORT;
            break;
        case STEP_HTML:
            
	    DoHTML(htmlList[0].ID, inBuf, aSize);
            htmlList[0].Step = STEP_WAIT_SEND_OK;
            result = WRITE_PORT;
            break;
        };
        
    };
    return result;
};

void CopyCIPSEND(int aData1, int aData2, char *inBuf)
{
  copy_P(inBuf, AT_CIPSEND_1);
  sprintf(inBuf + strlen(inBuf), "%d", aData1);
  copy_P(inBuf + strlen(inBuf), AT_CIPSEND_2);
  sprintf(inBuf + strlen(inBuf), "%d", aData2);
  copy_P(inBuf + strlen(inBuf), AT_CIPSEND_3);
}

char  DoSendAT(int aID, int aAnswerID, char *inBuf, unsigned int *aSize)
{
    char result = 1;
    int i;
    int sz;
    
    //ClearHTMLString();
    
    switch (aAnswerID)
    {
    case PAGE_OK:
        copy_P(HTMLString, AnswerOK);
        //sprintf(inBuf, "AT+CIPSEND=%d,%d\r\n", aID, strlen(HTMLString));
        CopyCIPSEND(aID, strlen(HTMLString), inBuf);
        break;
    case PAGE_MAIN:
        copy_P(inBuf, AnswerMain);
        sz = strlen(inBuf); // размер AnswerMain
        
        copy_P(inBuf, AnswerHead);
        sprintf(HTMLString, "%s%d", inBuf, sz); // Заголовок с размером AnswerMain
        copy_P(HTMLString + strlen(HTMLString), AT_CIPSEND_3);
        copy_P(HTMLString + strlen(HTMLString), AT_CIPSEND_3);
        copy_P(inBuf, AnswerMain);
        sz = strlen(inBuf) + strlen(HTMLString); // Размер пакета с заголовком
        //*** Создаем пакет с заголовком в HTMLString
        
        strcat (HTMLString, inBuf);
        
        //sprintf(inBuf, "AT+CIPSEND=%d,%d\r\n", aID, sz);
        CopyCIPSEND(aID, sz, inBuf);
        break;
    case PAGE_MAIN_MENU:
        copy_P(inBuf, AnswerMainMenu);
        sz = strlen(inBuf); // размер AnswerMain
        
        copy_P(inBuf, AnswerHead);
        sprintf(HTMLString, "%s%d", inBuf, sz); // Заголовок с размером AnswerMain
        copy_P(HTMLString + strlen(HTMLString), AT_CIPSEND_3);
        copy_P(HTMLString + strlen(HTMLString), AT_CIPSEND_3);
        copy_P(inBuf, AnswerMainMenu);
        sz = strlen(inBuf) + strlen(HTMLString); // Размер пакета с заголовком
        //*** Создаем пакет с заголовком в HTMLString
        
        strcat (HTMLString, inBuf);
        
        //sprintf(inBuf, "AT+CIPSEND=%d,%d\r\n", aID, sz);
        CopyCIPSEND(aID, sz, inBuf);
        break;        
    case PAGE_MENU:
        CurrentMenu = 0;
        StepCount = 0;
        CreateMenuForBrowser();
        sz = strlen(HTMLString);
        copy_P(inBuf, AnswerHead);
        sprintf(inBuf + strlen(inBuf), "%d", sz);
        copy_P(inBuf + strlen(inBuf), AT_CIPSEND_3);
        copy_P(inBuf + strlen(inBuf), AT_CIPSEND_3);
        sz = strlen(inBuf) + strlen(HTMLString);
        strcat(inBuf, HTMLString);
        sprintf(HTMLString, "%s", inBuf);
                
        //sprintf(inBuf, "AT+CIPSEND=%d,%d\r\n", aID, sz);
        CopyCIPSEND(aID, sz, inBuf);
        break;
    case PAGE_MENU_1:
        CurrentMenu = 1;
        StepCount = 0;
        CreateMenuForBrowser_1();
        sz = strlen(HTMLString);
        copy_P(inBuf, AnswerHead);
        sprintf(inBuf + strlen(inBuf), "%d", sz);
        copy_P(inBuf + strlen(inBuf), AT_CIPSEND_3);
        copy_P(inBuf + strlen(inBuf), AT_CIPSEND_3);
        sz = strlen(inBuf) + strlen(HTMLString);
        strcat(inBuf, HTMLString);
        sprintf(HTMLString, "%s", inBuf);
                
        //sprintf(inBuf, "AT+CIPSEND=%d,%d\r\n", aID, sz);
        CopyCIPSEND(aID, sz, inBuf);
        break;    
    case PAGE_MENU_ARHIVE:
        CurrentMenu = 2;
        StepCount = 0;
        CreateMenuForBrowser_2();
        sz = strlen(HTMLString);
        copy_P(inBuf, AnswerHead);
        sprintf(inBuf + strlen(inBuf), "%d", sz);
        copy_P(inBuf + strlen(inBuf), AT_CIPSEND_3);
        copy_P(inBuf + strlen(inBuf), AT_CIPSEND_3);
        sz = strlen(inBuf) + strlen(HTMLString);
        strcat(inBuf, HTMLString);
        sprintf(HTMLString, "%s", inBuf);
                
        //sprintf(inBuf, "AT+CIPSEND=%d,%d\r\n", aID, sz);
        CopyCIPSEND(aID, sz, inBuf);
        break;        
        
    case PAGE_ERROR:
        copy_P(HTMLString, AnswerError);
        
        //sprintf(inBuf, "AT+CIPSEND=%d,%d\r\n", aID, strlen(HTMLString));
        CopyCIPSEND(aID, strlen(HTMLString), inBuf);
        break;
    default:
        if (StepCount == 0)
        {
          switch (CurrentMenu)
          {
          case 0: 
            CreatPageForBrowser(aAnswerID);
            break;
          case 1: 
            CreatPageForBrowser_1(aAnswerID);
            break;
          case 2: 
            CreatPageForBrowser_2(aAnswerID);
            break;
          default:
            return 0;
          }
        
          sz = strlen(HTMLString);
          copy_P(inBuf, AnswerHead);
          sprintf(inBuf + strlen(inBuf), "%d", sz); 
          copy_P(inBuf + strlen(inBuf), AT_CIPSEND_3);
          copy_P(inBuf + strlen(inBuf), AT_CIPSEND_3);
          
          sz = strlen(inBuf) + strlen(HTMLString);
          if(sz < MAX_SIZE_ONE_HTML_PACKET)//if (sz < 2048)
          {  
          strcat(inBuf, HTMLString);
          sprintf(HTMLString, "%s", inBuf);

          CopyCIPSEND(aID, sz, inBuf);
          }
          else
          {
            for (i = strlen(HTMLString) - 1; i >= 0; i--)
              HTMLString[strlen(inBuf) + i] = HTMLString[i];
            for (i = 0; i < strlen(inBuf); i++)
              HTMLString[i] = inBuf[i];
            CopyCIPSEND(aID, MAX_SIZE_ONE_HTML_PACKET, inBuf);
          }
        }
        else
        {
          sz = strlen(HTMLString);
          if (sz < MAX_SIZE_ONE_HTML_PACKET) //if (sz < 2048)
            CopyCIPSEND(aID, sz, inBuf);
          else
            CopyCIPSEND(aID, MAX_SIZE_ONE_HTML_PACKET, inBuf);
        }
    };
    
    
    //sprintf(inBuf,"%s", sDoSendAT);
    *aSize = strlen(inBuf);
    return result;
};

// Меню для браузера

char CreateMenuForBrowser()
{
    int i, j;
    
    ClearHTMLString();    
    //sprintf (HTMLString , "%s", "<html>\r\n <body link=\"white\" alink=\"yellow\" vlink=\"white\" style=\"background: #0066FF\">\r\n");
    copy_P(HTMLString, html_menu_begin);

    for (i = 0; i <= MAX_ARRSECTION - 1; i++)
    {
        for (j = 0; j < SECTION_SIZE; j++)
            SectionName[j] = 0;
        
        copy_P(SectionName, ArrSection[i]);
        
        //sprintf(HTMLString + strlen(HTMLString) - 1, "<li><a href=\"%d\" target=\"r\">%s</a></li>\r\n", i, SectionName);
        
        copy_P(HTMLString + strlen(HTMLString), html_menu_1);
        sprintf(HTMLString + strlen(HTMLString), "%d", i);
        copy_P(HTMLString + strlen(HTMLString), html_menu_2);
        sprintf(HTMLString + strlen(HTMLString), "%s", SectionName);
        copy_P(HTMLString + strlen(HTMLString), html_menu_3);
 

    };
    //strcat(HTMLString, "</body>\r\n</html>\r\n");
    copy_P(HTMLString + strlen(HTMLString), html_menu_end);
    return 1;

};

// Меню1 для браузера

char CreateMenuForBrowser_1()
{
    int i, j;
    
    ClearHTMLString();    
    
    copy_P(HTMLString, html_menu_begin);

    for (i = 0; i <= MAX_ARRSECTION_1 - 1; i++)
    {
        for (j = 0; j < SECTION_SIZE; j++)
            SectionName[j] = 0;
        
        copy_P(SectionName, ArrSection_1[i]);
        
        copy_P(HTMLString + strlen(HTMLString), html_menu_1);
        sprintf(HTMLString + strlen(HTMLString), "%d", i);
        copy_P(HTMLString + strlen(HTMLString), html_menu_2);
        sprintf(HTMLString + strlen(HTMLString), "%s", SectionName);
        copy_P(HTMLString + strlen(HTMLString), html_menu_3);
 

    };
    
    copy_P(HTMLString + strlen(HTMLString), html_menu_end);
    return 1;

};

char CreateMenuForBrowser_2()
{
    int i, j;
    
    ClearHTMLString();    
    
    copy_P(HTMLString, html_menu_begin);

    for (i = 0; i <= MAX_ARRSECTION_2 - 1; i++)
    {
        for (j = 0; j < SECTION_SIZE; j++)
            SectionName[j] = 0;
        
        copy_P(SectionName, ArrSection_2[i]);
        
        copy_P(HTMLString + strlen(HTMLString), html_menu_1);
        sprintf(HTMLString + strlen(HTMLString), "%d", i);
        copy_P(HTMLString + strlen(HTMLString), html_menu_2);
        sprintf(HTMLString + strlen(HTMLString), "%s", SectionName);
        copy_P(HTMLString + strlen(HTMLString), html_menu_3);
 

    };
    
    copy_P(HTMLString + strlen(HTMLString), html_menu_end);
    return 1;

};


TParamItem GetParam(const char *src)
{
  /*  int i;


    for (i = 0; i < sizeof(TParamItem); i++)
        CharToParamItem.buf[i] = *src++;

    return CharToParamItem.Pitem;
  */
    int i;
    char *p;

    p=&PItem.Name[0];
    for (i = 0; i < sizeof(TParamItem); i++)
    //    CharToParamItem.buf[i] = *src++;
      p[i]=*src++;

   // return CharToParamItem.Pitem;
    return PItem;
};

char GetCountWord(void)
{
    switch (PItem.TypeValue)
    {
    case INT: return 1;
    case UINT: return 1;
    case DINT: return 2;
    case UDINT: return 2;
    case REAL: return 2;
    case STR: return PItem.BitFieldCount/2;
    default: return 0;
    };
};

unsigned int GetMaskInt(char aBitFieldStart, char aBitFieldCount)
{
    int i;
    unsigned int result, d;

    result = 0;
    for (i = aBitFieldStart; i < aBitFieldStart + aBitFieldCount; i++)
    {
        d = 1 << i;
        result = result + d;
    };
    return result;
};

unsigned long int GetMaskWord(char aBitFieldStart, char aBitFieldCount)
{
    int i;
    unsigned long int result, d;
    result = 0;
    for (i = aBitFieldStart; i < aBitFieldStart + aBitFieldCount; i++)
    {
        d = 1 << i;
        result = result + d;
    };
    return result;
};

char WriteDataToMemory(char *aValStr)
{
    char sz;
    int16_t val_int;
    uint32_t mask32, val_long;
    uint16_t mask16;
    
    
    // sz -количество слов которое надо прочитать, если 0 то ничего не делать
    sz = GetCountWord();
    if (sz == 0)
        return 0;
    if (PItem.isBitField)
    {
        if (read_modbus(READ_DATA, PItem.Adres, sz, ValData) == 0)
            return 0;
    }
    

    switch (PItem.TypeValue)
    {
    case INT: 
        val_int = atoi(aValStr);
        if (PItem.isBitField)
        {
            mask16 = GetMaskInt(PItem.BitFieldStart, PItem.BitFieldCount);
            ValData[0] = ValData[0] & (~mask16);
            val_int = val_int << PItem.BitFieldStart;
            ValData[0] = ValData[0] | val_int;

        }
        else
            ValData[0] = val_int;

        break;
    case UINT: 
        val_int = atoi(aValStr);
        if (PItem.isBitField)
        {
            mask16 = GetMaskInt(PItem.BitFieldStart, PItem.BitFieldCount);
            ValData[0] = ValData[0] & (~mask16);
            val_int = val_int << PItem.BitFieldStart;
            ValData[0] = ValData[0] | val_int;

        }
        else
            ValData[0] = val_int;
        
        break;
    case DINT: 

        val_long = atol(aValStr);
        if (PItem.isBitField)
        {
            val_Integer.Word[0] = ValData[0];
            val_Integer.Word[1] = ValData[1];          
            mask32 = GetMaskInt(PItem.BitFieldStart, PItem.BitFieldCount);
            val_Integer.Value = val_Integer.Value & (~mask32);
            val_long = val_long << PItem.BitFieldStart;
            val_Integer.Value = val_DWord.Value | val_long;
            ValData[0] = val_Integer.Word[0];
            ValData[1] = val_Integer.Word[1];
        }
        else
        {
            val_Integer.Value = val_long;
            ValData[0] = val_Integer.Word[0];
            ValData[1] = val_Integer.Word[1];

        };
        break;
    case UDINT:
        
        val_long = atol(aValStr);
        if (PItem.isBitField)
        {
            val_DWord.Word[0] = ValData[0];
            val_DWord.Word[1] = ValData[1];
            mask32 = GetMaskInt(PItem.BitFieldStart, PItem.BitFieldCount);
            val_DWord.Value = val_Integer.Value & (~mask32);
            val_long = val_long << PItem.BitFieldStart;
            val_DWord.Value = val_DWord.Value | val_long;
            ValData[0] = val_DWord.Word[0];
            ValData[1] = val_DWord.Word[1];
        }
        else
        {
            val_DWord.Value = val_long;
            ValData[0] = val_DWord.Word[0];
            ValData[1] = val_DWord.Word[1];

        };

        break;
    case REAL:
        val_Float.Value = atof(aValStr); //StrToFloat(aValStr); 
        ValData[0] = val_Float.Word[0];
        ValData[1] = val_Float.Word[1];
        break;

  default: return 0;
  };


    if (read_modbus(WRITE_DATA, PItem.Adres, sz, ValData) == 0)
        return 0;
    return 1;
};

char ReadDataFromMemory(char *aValStr)
{
    char sz;
    int i;
    int16_t val_int; 
    uint32_t mask32;
    uint16_t mask16;
    
    // sz -количество слов которое надо прочитать, если 0 то ничего не делать
    sz = GetCountWord();
    if (sz == 0)
        return 0;

    if (read_modbus(READ_DATA, PItem.Adres, sz, ValData) == 0)
        return 0;
    
  
    switch (PItem.TypeValue)
    {
    case INT: 
        val_int = (int16_t)ValData[0];
        if (PItem.isBitField)
        {
            mask16 = GetMaskInt(PItem.BitFieldStart, PItem.BitFieldCount);
            val_int = val_int & mask16;
            val_int = val_int >> PItem.BitFieldStart;
            ValData[0] = val_int;

        };
        sprintf(aValStr, "%d", val_int);

        break;
    case UINT: 
        if (PItem.isBitField)
        {
            mask16 = GetMaskInt(PItem.BitFieldStart, PItem.BitFieldCount);
            ValData[0] = ValData[0] & mask16;
            ValData[0] = ValData[0] >> PItem.BitFieldStart;

        };
        sprintf(aValStr, "%u", ValData[0]);
        break;
    case DINT: 
        val_Integer.Word[0] = ValData[0];
        val_Integer.Word[1] = ValData[1];
        if (PItem.isBitField)
        {
            mask32 = GetMaskInt(PItem.BitFieldStart, PItem.BitFieldCount);
            val_Integer.Value = val_Integer.Value & mask32;
            val_Integer.Value = val_Integer.Value >> PItem.BitFieldStart;
        };
        sprintf(aValStr, "%ld", val_Integer.Value);
        break;
    case UDINT:
        val_DWord.Word[0] = ValData[0];
        val_DWord.Word[1] = ValData[1];
        if (PItem.isBitField)
        {
            mask32 = GetMaskInt(PItem.BitFieldStart, PItem.BitFieldCount);
            val_DWord.Value = val_DWord.Value & mask32;
            val_DWord.Value = val_DWord.Value >> PItem.BitFieldStart;
        };
        sprintf(aValStr, "%lu", val_DWord.Value);

        break;
    case REAL:
        val_Float.Word[0] = ValData[0];
        val_Float.Word[1] = ValData[1];
        //if (FloatToStr(val_Float.Value, aValStr) == 0)
        //  aValStr[0] = 0;
        sprintf(aValStr, "%f", (double)val_Float.Value);
        break;
    case STR:
        for (i = 0; i < MAX_COUNT_WORD; i++)
        {
          aValStr[i * 2 + 1] = ValData[i] & 0xff;
          aValStr[i * 2] = ValData[i] >> 8;
        }
        break;
  default: return 0;
  };

 
    return 1;
};

int GetLastIndexArhive(void)
{
  if (read_modbus(READ_DATA, ADRES_ARHIVE_INDEX, 1, ValData) == 0)
        return -1; 
  return ValData[0];
};

uint16_t ReadDataFromArhive(char *aValStr, int aDirect, char *qwality)
{
  uint16_t temp,sum,i,reg; 
  *qwality=0;
    if (read_modbus(READ_DATA, ADRES_ARHIVE + CurrentArhiveIndex * 7, 7, ValData) == 0)
        return 0;
    
    sum=0;
    for(i=0; i< 6; i++) {
      reg=ValData[i];
      sum += (reg & 0xff);
      sum +=  (reg >>8);
    }
   
    reg=ValData[6];
    if(reg != sum) return 0;
    *qwality=1;
    temp=CurrentArhiveIndex;
    
    val_DWord.Word[0] = ValData[0];
    val_DWord.Word[1] = ValData[1];
    convert_unix_2_date(val_DWord.Value); 
    
    aValStr[0] = (u_2_date/10) + 0x30;
    aValStr[1] = (u_2_date%10) + 0x30;
    aValStr[2] = '.';
    aValStr[3] = (u_2_month/10) + 0x30;
    aValStr[4] = (u_2_month%10) + 0x30;
    aValStr[5] = '.';
    aValStr[6] = '2';
    aValStr[7] = '0';
    aValStr[8] = (u_2_year/10) + 0x30;
    aValStr[9] = (u_2_year%10) + 0x30;
    aValStr[10] = ' ';        
    aValStr[11] = (u_2_hor/10) + 0x30;
    aValStr[12] = (u_2_hor%10) + 0x30;
    aValStr[13] = ':';
    aValStr[14] = (u_2_min/10) + 0x30;
    aValStr[15] = (u_2_min%10) + 0x30;
    aValStr[16] = ':';
    aValStr[17] = (u_2_sec/10) + 0x30; 
    aValStr[18] = (u_2_sec%10) + 0x30; 
    aValStr[19] = ' ';
    aValStr[20] = 0;
    
    
    //sprintf(aValStr + strlen(aValStr), "%u", ValData[5]);
    
    switch (aDirect)
    {
    case 0:// Предыдущий
    case 2: // Текущий    
      if (CurrentArhiveIndex == 0) 
        CurrentArhiveIndex = MAX_ARHIVE_STACK - 1;
      else
        CurrentArhiveIndex--;
      break;
    case 1:// Следующий
      if (CurrentArhiveIndex == MAX_ARHIVE_STACK - 1)
        CurrentArhiveIndex = 0;
      else
        CurrentArhiveIndex++;      
      break;
    default:
      return 0;
    }

    return (temp);
};

void ClearHTMLString(void)
{
  int i;
  for (i = 0; i < MAX_SIZE_HTML_PACKET; i++)
    HTMLString[i] = 0;
}

// страница с параметрами для браузера
char CreatPageForBrowser(int aIndex)
{
    int i;
    
    ClearHTMLString();

    
    if (ColorHtmlText == 0)
      copy_P(HTMLString, html_text_black); //sprintf (HTMLString , "%s", "<html>\r\n <body text = \"#000000\">\r\n");
    else
      copy_P(HTMLString, html_text_blue); //sprintf (HTMLString , "%s", "<html>\r\n <body text = \"#0000ff\">\r\n");
    
    //sprintf (HTMLString + strlen(HTMLString) - 1, "%s","<form action='/' method='POST'>\r\n");
    //strcat(HTMLString, "<br>\r\n");
    copy_P(HTMLString + strlen(HTMLString), html_method);
    
    for (i = 0; i < SECTION_SIZE; i++)
        SectionName[i] = 0;
    copy_P(SectionName, ArrSection[aIndex]);

    //sprintf (HTMLString + strlen(HTMLString) - 1, "<font color=\"#ff0000\">Раздел: %s</font>\r\n", SectionName);
    //strcat(HTMLString, "<br>\r\n");
    //strcat(HTMLString, "<font size=\"-2\">\r\n");
    copy_P(HTMLString + strlen(HTMLString), html_font_color_1);
    sprintf (HTMLString + strlen(HTMLString), "%s", SectionName);
    copy_P(HTMLString + strlen(HTMLString), html_font_color_2);
    
    for (i = 0; i <= MAX_PARAM_ITEM - 1; i++)
    {
        
        PItem = GetParam(&ParamItem[i].Name[0]);

        if (PItem.SectionIndex == aIndex)
        {
            CurrentMenu = 0;
            ReadDataFromMemory(ValStr);
            
            sprintf(HTMLString + strlen(HTMLString), "%s", PItem.Name);
            //sprintf(HTMLString + strlen(HTMLString) - 1, "\r\n<input type='text' name='%s%d' size='10' value='%s'>\r\n", NAME_POST, i, ValStr);
            //strcat(HTMLString, "<br>\r\n");
            copy_P(HTMLString + strlen(HTMLString), html_input_type_1);
            sprintf(HTMLString + strlen(HTMLString), "%s%d", NAME_POST, i);
            copy_P(HTMLString + strlen(HTMLString), html_input_type_2);
            sprintf(HTMLString + strlen(HTMLString), "%s", ValStr);
            copy_P(HTMLString + strlen(HTMLString), html_input_type_3);
        };
    };
    //strcat(HTMLString, "</font>\r\n");
    //strcat(HTMLString, "<input type='submit' value='OK'>\r\n</form>\r\n");
    //strcat(HTMLString, "</body>\r\n </html>\r\n");
    copy_P(HTMLString + strlen(HTMLString), html_end);
    
    return 1;
};

// страница с параметрами для браузера чтение
char CreatPageForBrowser_1(int aIndex)
{
    int i;
    
    ClearHTMLString();

    
    if (ColorHtmlText == 0)
      copy_P(HTMLString, html_text_black);
    else
      copy_P(HTMLString, html_text_blue);

    copy_P(HTMLString + strlen(HTMLString), html_method_get_1);
    sprintf(HTMLString + strlen(HTMLString), "%d", aIndex);
    copy_P(HTMLString + strlen(HTMLString), html_method_get_2);
    
    for (i = 0; i < SECTION_SIZE; i++)
        SectionName[i] = 0;
    copy_P(SectionName, ArrSection_1[aIndex]);

    copy_P(HTMLString + strlen(HTMLString), html_font_color_1);
    sprintf(HTMLString + strlen(HTMLString), "%s", SectionName);
    copy_P(HTMLString + strlen(HTMLString), html_font_color_2);
    
    for (i = 0; i <= MAX_PARAM_ITEM_1 - 1; i++)
    {
        
        PItem = GetParam(&ParamItem_1[i].Name[0]);

        if (PItem.SectionIndex == aIndex)
        {
            CurrentMenu = 1;
            //************
            if (Pos("Wat", PItem.Name, 0) > -1)
            {
              CreatPageForBrowserWat(aIndex);
              return 1;
            };
            
            if (Pos("Dyn", PItem.Name, 0) > -1)
            {
              CreatPageForBrowserDyn(aIndex);
              return 1;
            };
            
            
            //*************
            ReadDataFromMemory(ValStr);
            
            copy_P(HTMLString + strlen(HTMLString), html_text_1);
            sprintf(HTMLString + strlen(HTMLString), "%s", PItem.Name);
            copy_P(HTMLString + strlen(HTMLString), html_text_2);
            sprintf(HTMLString + strlen(HTMLString), "%s", ValStr);
            copy_P(HTMLString + strlen(HTMLString), html_text_3);
            
        };
    };
    copy_P(HTMLString + strlen(HTMLString), html_end_1);
    
    return 1;
};
float GetMaxY()
{
  int i;
  int16_t val_int;
  float result;
  
  result = 0;
  
  for (i = 0; i < 5; i++)
  {
     switch (inBuffer[8 + i * 10])
     {  
     case D_ONE_LINE:
        switch (inBuffer[7 + i * 10])
        {  
         case T_INT:
            val_int = (int16_t)(inBuffer[9 + i * 10] * 256 + inBuffer[10 + i * 10]);
            if (val_int > result)
              result = val_int;
            break;
         case T_UINT:
            if ((inBuffer[9 + i * 10] * 256 + inBuffer[10 + i * 10]) > result)
              result = inBuffer[9 + i * 10] * 256 + inBuffer[10 + i * 10];
            break;
         case T_DINT:
            val_Integer.Word[0] = inBuffer[9 + i * 10] * 256 + inBuffer[10 + i * 10];
            val_Integer.Word[1] = inBuffer[11 + i * 10] * 256 + inBuffer[12 + i * 10]; 
            if (val_Integer.Value > result)
              result = val_Integer.Value;
            break;
         case T_UDINT:
            val_DWord.Word[0] = inBuffer[9 + i * 10] * 256 + inBuffer[10 + i * 10];
            val_DWord.Word[1] = inBuffer[11 + i * 10] * 256 + inBuffer[12 + i * 10];
            if (val_DWord.Value > result)
              result = val_DWord.Value;
            break;
         case T_REAL:
            val_Float.Word[0] = inBuffer[9 + i * 10] * 256 + inBuffer[10 + i * 10];
            val_Float.Word[1] = inBuffer[11 + i * 10] * 256 + inBuffer[12 + i * 10];
            if (val_Float.Value > result)
              result = val_Float.Value;
            break;
        };
        break;
     case D_TWO_LINE:
        switch (inBuffer[7 + i * 10])
        {  
         case T_INT:
            val_int = (int16_t)(inBuffer[9 + i * 10] * 256 + inBuffer[10 + i * 10]);
            if (val_int > result)
              result = val_int;
           
            val_int = (int16_t)(inBuffer[13 + i * 10] * 256 + inBuffer[14 + i * 10]);
            if (val_int > result)
              result = val_int;
            break;
         case T_UINT:
     
            if ((inBuffer[9 + i * 10] * 256 + inBuffer[10 + i * 10]) > result)
              result = inBuffer[9 + i * 10] * 256 + inBuffer[10 + i * 10];
           
            if ((inBuffer[13 + i * 10] * 256 + inBuffer[14 + i * 10]) > result)
              result = inBuffer[13 + i * 10] * 256 + inBuffer[14 + i * 10];
            break;
         case T_DINT:
            val_Integer.Word[0] = inBuffer[9 + i * 10] * 256 + inBuffer[10 + i * 10];
            val_Integer.Word[1] = inBuffer[11 + i * 10] * 256 + inBuffer[12 + i * 10]; 
            if (val_Integer.Value > result)
              result = val_Integer.Value;
           
            val_Integer.Word[0] = inBuffer[13 + i * 10] * 256 + inBuffer[14 + i * 10];
            val_Integer.Word[1] = inBuffer[15 + i * 10] * 256 + inBuffer[16 + i * 10]; 
            if (val_Integer.Value > result)
              result = val_Integer.Value;
            break;
         case T_UDINT:
            val_DWord.Word[0] = inBuffer[9 + i * 10] * 256 + inBuffer[10 + i * 10];
            val_DWord.Word[1] = inBuffer[11 + i * 10] * 256 + inBuffer[12 + i * 10];
            if (val_DWord.Value > result)
              result = val_DWord.Value;
           
            val_DWord.Word[0] = inBuffer[13 + i * 10] * 256 + inBuffer[14 + i * 10];
            val_DWord.Word[1] = inBuffer[15 + i * 10] * 256 + inBuffer[16 + i * 10];
            if (val_DWord.Value > result)
              result = val_DWord.Value;
            break;
         case T_REAL:
            val_Float.Word[0] = inBuffer[9 + i * 10] * 256 + inBuffer[10 + i * 10];
            val_Float.Word[1] = inBuffer[11 + i * 10] * 256 + inBuffer[12 + i * 10];
            if (val_Float.Value > result)
              result = val_Float.Value;
           
            val_Float.Word[0] = inBuffer[13 + i * 10] * 256 + inBuffer[14 + i * 10];
            val_Float.Word[1] = inBuffer[15 + i * 10] * 256 + inBuffer[16 + i * 10];
            if (val_Float.Value > result)
              result = val_Float.Value;
            break;
        };
        break;
     case D_POINT:
     case D_POINT_STAR:
        switch (inBuffer[7 + i * 10])
        {  
         case T_INT:
            val_int = (int16_t)(inBuffer[13 + i * 10] * 256 + inBuffer[14 + i * 10]);
            if (val_int > result)
              result = val_int;
            break;
         case T_UINT:
            if ((inBuffer[13 + i * 10] * 256 + inBuffer[14 + i * 10]) > result)
              result = inBuffer[9 + i * 10] * 256 + inBuffer[10 + i * 10];
            break;
         case T_DINT:
            val_Integer.Word[0] = inBuffer[13 + i * 10] * 256 + inBuffer[14 + i * 10];
            val_Integer.Word[1] = inBuffer[15 + i * 10] * 256 + inBuffer[16 + i * 10]; 
            if (val_Integer.Value > result)
              result = val_Integer.Value;
            break;
         case T_UDINT:
            val_DWord.Word[0] = inBuffer[13 + i * 10] * 256 + inBuffer[14 + i * 10];
            val_DWord.Word[1] = inBuffer[15 + i * 10] * 256 + inBuffer[16 + i * 10];
            if (val_DWord.Value > result)
              result = val_DWord.Value;
            break;
         case T_REAL:
            val_Float.Word[0] = inBuffer[13 + i * 10] * 256 + inBuffer[14 + i * 10];
            val_Float.Word[1] = inBuffer[15 + i * 10] * 256 + inBuffer[16 + i * 10];
            if (val_Float.Value > result)
              result = val_Float.Value;
            break;
        };
        break;        
     };
   
  };
  return result;
};

void DrawLine(uint16_t maxX, uint16_t maxY)
{
  int i;
  int16_t val_int;
  uint16_t val_uint; 
    
  for (i = 0; i < 5; i++)
  {
     switch (inBuffer[8 + i * 10])
     {  
     case D_ONE_LINE:
        switch (inBuffer[7 + i * 10])
        {  
         case T_INT:
            val_int = (int16_t)(inBuffer[9 + i * 10] * 256 + inBuffer[10 + i * 10]);
            strcat(HTMLString, "ctx.beginPath();\r\n");
            strcat(HTMLString, "ctx.strokeStyle = \"#0000ff\";\r\n"); //цвет линий
            strcat(HTMLString, "ctx.setLineDash([10]);\r\n");
            sprintf(HTMLString + strlen(HTMLString),"ctx.moveTo(s,(%d + %d)*kY+s);\r\n", (-1)*val_int, val_int);
            sprintf(HTMLString + strlen(HTMLString),"ctx.lineTo(%d*kX+s,(%d + %d)*kY+s);\r\n", maxX, (-1)*val_int, maxY);
            strcat(HTMLString, "ctx.stroke();\r\n");
            sprintf(HTMLString + strlen(HTMLString),"ctx.fillText(%d,s+2,(%d + %d)*kY+s-2);\r\n",val_int, (-1)*val_int, maxY); 

            break;
         case T_UINT:
            val_uint = inBuffer[9 + i * 10] * 256 + inBuffer[10 + i * 10];
            strcat(HTMLString, "ctx.beginPath();\r\n");
            strcat(HTMLString, "ctx.strokeStyle = \"#0000ff\";\r\n"); //цвет линий
            strcat(HTMLString, "ctx.setLineDash([10]);\r\n");
            sprintf(HTMLString + strlen(HTMLString),"ctx.moveTo(s,(%d + %d)*kY+s);\r\n", (-1)*val_uint, maxY);
            sprintf(HTMLString + strlen(HTMLString),"ctx.lineTo(%d*kX+s,(%d + %d)*kY+s);\r\n", maxX, (-1)*val_uint, maxY);
            strcat(HTMLString, "ctx.stroke();\r\n");
            sprintf(HTMLString + strlen(HTMLString),"ctx.fillText(%d,s+2,(%d + %d)*kY+s-2);\r\n",val_uint, (-1)*val_uint, maxY); 
            break;
         case T_DINT:
            val_Integer.Word[0] = inBuffer[9 + i * 10] * 256 + inBuffer[10 + i * 10];
            val_Integer.Word[1] = inBuffer[11 + i * 10] * 256 + inBuffer[12 + i * 10]; 
            strcat(HTMLString, "ctx.beginPath();\r\n");
            strcat(HTMLString, "ctx.strokeStyle = \"#0000ff\";\r\n"); //цвет линий
            strcat(HTMLString, "ctx.setLineDash([10]);\r\n");
            sprintf(HTMLString + strlen(HTMLString),"ctx.moveTo(s,(%d + %d)*kY+s);\r\n", (-1)*val_Integer.Value, maxY);
            sprintf(HTMLString + strlen(HTMLString),"ctx.lineTo(%d*kX+s,(%d + %d)*kY+s);\r\n", maxX, (-1)*val_Integer.Value, maxY);
            strcat(HTMLString, "ctx.stroke();\r\n");
            sprintf(HTMLString + strlen(HTMLString),"ctx.fillText(%d,s+2,(%d + %d)*kY+s-2);\r\n",val_Integer.Value, (-1)*val_Integer.Value, maxY); 

            break;
         case T_UDINT:
            val_DWord.Word[0] = inBuffer[9 + i * 10] * 256 + inBuffer[10 + i * 10];
            val_DWord.Word[1] = inBuffer[11 + i * 10] * 256 + inBuffer[12 + i * 10];
            val_Integer.Word[0] = inBuffer[9 + i * 10] * 256 + inBuffer[10 + i * 10];
            val_Integer.Word[1] = inBuffer[11 + i * 10] * 256 + inBuffer[12 + i * 10]; 
            strcat(HTMLString, "ctx.beginPath();\r\n");
            strcat(HTMLString, "ctx.strokeStyle = \"#0000ff\";\r\n"); //цвет линий
            strcat(HTMLString, "ctx.setLineDash([10]);\r\n");
            sprintf(HTMLString + strlen(HTMLString),"ctx.moveTo(s,(%d + %d)*kY+s);\r\n", (-1)*val_DWord.Value, maxY);
            sprintf(HTMLString + strlen(HTMLString),"ctx.lineTo(%d*kX+s,(%d + %d)*kY+s);\r\n", maxX, (-1)*val_DWord.Value, maxY);
            strcat(HTMLString, "ctx.stroke();\r\n");
            sprintf(HTMLString + strlen(HTMLString),"ctx.fillText(%d,s+2,(%d + %d)*kY+s-2);\r\n",val_DWord.Value, (-1)*val_DWord.Value, maxY); 

            break;
         case T_REAL:
            val_Float.Word[0] = inBuffer[9 + i * 10] * 256 + inBuffer[10 + i * 10];
            val_Float.Word[1] = inBuffer[11 + i * 10] * 256 + inBuffer[12 + i * 10];
            strcat(HTMLString, "ctx.beginPath();\r\n");
            strcat(HTMLString, "ctx.strokeStyle = \"#0000ff\";\r\n"); //цвет линий
            strcat(HTMLString, "ctx.setLineDash([10]);\r\n");
            sprintf(HTMLString + strlen(HTMLString),"ctx.moveTo(s,(%f + %d)*kY+s);\r\n", (-1)*val_Float.Value, maxY);
            sprintf(HTMLString + strlen(HTMLString),"ctx.lineTo(%d*kX+s,(%f + %d)*kY+s);\r\n", maxX, (-1)*val_Float.Value, maxY);
            strcat(HTMLString, "ctx.stroke();\r\n");
            sprintf(HTMLString + strlen(HTMLString),"ctx.fillText(%f,s+2,(%f + %d)*kY+s-2);\r\n",val_Float.Value, (-1)*val_Float.Value, maxY);            
            break;
        };
        break;
     case D_TWO_LINE:
        switch (inBuffer[7 + i * 10])
        {  
         case T_INT:
            val_int = (int16_t)(inBuffer[9 + i * 10] * 256 + inBuffer[10 + i * 10]);
            strcat(HTMLString, "ctx.beginPath();\r\n");
            strcat(HTMLString, "ctx.strokeStyle = \"#008000\";\r\n"); //цвет линий
            strcat(HTMLString, "ctx.setLineDash([10]);\r\n");
            sprintf(HTMLString + strlen(HTMLString),"ctx.moveTo(s,(%d + %d)*kY+s);\r\n", (-1)*val_int, maxY);
            sprintf(HTMLString + strlen(HTMLString),"ctx.lineTo(%d*kX+s,(%d + %d)*kY+s);\r\n", maxX, (-1)*val_int, maxY);
            strcat(HTMLString, "ctx.stroke();\r\n");
            sprintf(HTMLString + strlen(HTMLString),"ctx.fillText(%d,s+2,(%d + %d)*kY+s-2);\r\n",val_int, (-1)*val_int, maxY); 
            
            val_int = (int16_t)(inBuffer[13 + i * 10] * 256 + inBuffer[14 + i * 10]);
            strcat(HTMLString, "ctx.beginPath();\r\n");
            strcat(HTMLString, "ctx.strokeStyle = \"#008000\";\r\n"); //цвет линий
            strcat(HTMLString, "ctx.setLineDash([10]);\r\n");
            sprintf(HTMLString + strlen(HTMLString),"ctx.moveTo(s,(%d + %d)*kY+s);\r\n", (-1)*val_int, maxY);
            sprintf(HTMLString + strlen(HTMLString),"ctx.lineTo(%d*kX+s,(%d + %d)*kY+s);\r\n", maxX, (-1)*val_int, maxY);
            strcat(HTMLString, "ctx.stroke();\r\n");
            sprintf(HTMLString + strlen(HTMLString),"ctx.fillText(%d,s+2,(%d + %d)*kY+s-2);\r\n",val_int, (-1)*val_int, maxY); 
            break;
         case T_UINT:
     
            val_uint = inBuffer[9 + i * 10] * 256 + inBuffer[10 + i * 10];
            strcat(HTMLString, "ctx.beginPath();\r\n");
            strcat(HTMLString, "ctx.strokeStyle = \"#008000\";\r\n"); //цвет линий
            strcat(HTMLString, "ctx.setLineDash([10]);\r\n");
            sprintf(HTMLString + strlen(HTMLString),"ctx.moveTo(s,(%d + %d)*kY+s);\r\n", (-1)*val_uint, maxY);
            sprintf(HTMLString + strlen(HTMLString),"ctx.lineTo(%d*kX+s,(%d + %d)*kY+s);\r\n", maxX, (-1)*val_uint, maxY);
            strcat(HTMLString, "ctx.stroke();\r\n");
            sprintf(HTMLString + strlen(HTMLString),"ctx.fillText(%d,s+2,(%d + %d)*kY+s-2);\r\n",val_uint, (-1)*val_uint, maxY); 

           
            val_uint = inBuffer[13 + i * 10] * 256 + inBuffer[14 + i * 10];
            strcat(HTMLString, "ctx.beginPath();\r\n");
            strcat(HTMLString, "ctx.strokeStyle = \"#008000\";\r\n"); //цвет линий
            strcat(HTMLString, "ctx.setLineDash([10]);\r\n");
            sprintf(HTMLString + strlen(HTMLString),"ctx.moveTo(s,(%d + %d)*kY+s);\r\n", (-1)*val_uint, maxY);
            sprintf(HTMLString + strlen(HTMLString),"ctx.lineTo(%d*kX+s,(%d + %d)*kY+s);\r\n", maxX, (-1)*val_uint, maxY);
            strcat(HTMLString, "ctx.stroke();\r\n");
            sprintf(HTMLString + strlen(HTMLString),"ctx.fillText(%d,s+2,(%d + %d)*kY+s-2);\r\n",val_uint, (-1)*val_uint, maxY); 
            break;
         case T_DINT:
            val_Integer.Word[0] = inBuffer[9 + i * 10] * 256 + inBuffer[10 + i * 10];
            val_Integer.Word[1] = inBuffer[11 + i * 10] * 256 + inBuffer[12 + i * 10]; 
            strcat(HTMLString, "ctx.beginPath();\r\n");
            strcat(HTMLString, "ctx.strokeStyle = \"#008000\";\r\n"); //цвет линий
            strcat(HTMLString, "ctx.setLineDash([10]);\r\n");
            sprintf(HTMLString + strlen(HTMLString),"ctx.moveTo(s,(%d + %d)*kY+s);\r\n", (-1)*val_Integer.Value, maxY);
            sprintf(HTMLString + strlen(HTMLString),"ctx.lineTo(%d*kX+s,(%d + %d)*kY+s);\r\n", maxX, (-1)*val_Integer.Value, maxY);
            strcat(HTMLString, "ctx.stroke();\r\n");
            sprintf(HTMLString + strlen(HTMLString),"ctx.fillText(%d,s+2,(%d + %d)*kY+s-2);\r\n",val_Integer.Value, (-1)*val_Integer.Value, maxY); 
           
            val_Integer.Word[0] = inBuffer[13 + i * 10] * 256 + inBuffer[14 + i * 10];
            val_Integer.Word[1] = inBuffer[15 + i * 10] * 256 + inBuffer[16 + i * 10]; 
            strcat(HTMLString, "ctx.beginPath();\r\n");
            strcat(HTMLString, "ctx.strokeStyle = \"#008000\";\r\n"); //цвет линий
            strcat(HTMLString, "ctx.setLineDash([10]);\r\n");
            sprintf(HTMLString + strlen(HTMLString),"ctx.moveTo(s,(%d + %d)*kY+s);\r\n", (-1)*val_Integer.Value, maxY);
            sprintf(HTMLString + strlen(HTMLString),"ctx.lineTo(%d*kX+s,(%d + %d)*kY+s);\r\n", maxX, (-1)*val_Integer.Value, maxY);
            strcat(HTMLString, "ctx.stroke();\r\n");
            sprintf(HTMLString + strlen(HTMLString),"ctx.fillText(%d,s+2,(%d + %d)*kY+s-2);\r\n",val_Integer.Value, (-1)*val_Integer.Value, maxY); 
            break;
         case T_UDINT:
            val_DWord.Word[0] = inBuffer[9 + i * 10] * 256 + inBuffer[10 + i * 10];
            val_DWord.Word[1] = inBuffer[11 + i * 10] * 256 + inBuffer[12 + i * 10];
            strcat(HTMLString, "ctx.beginPath();\r\n");
            strcat(HTMLString, "ctx.strokeStyle = \"#008000\";\r\n"); //цвет линий
            strcat(HTMLString, "ctx.setLineDash([10]);\r\n");
            sprintf(HTMLString + strlen(HTMLString),"ctx.moveTo(s,(%d + %d)*kY+s);\r\n", (-1)*val_DWord.Value, maxY);
            sprintf(HTMLString + strlen(HTMLString),"ctx.lineTo(%d*kX+s,(%d + %d)*kY+s);\r\n", maxX, (-1)*val_DWord.Value, maxY);
            strcat(HTMLString, "ctx.stroke();\r\n");
            sprintf(HTMLString + strlen(HTMLString),"ctx.fillText(%d,s+2,(%d + %d)*kY+s-2);\r\n",val_DWord.Value, (-1)*val_DWord.Value, maxY); 
           
            val_DWord.Word[0] = inBuffer[13 + i * 10] * 256 + inBuffer[14 + i * 10];
            val_DWord.Word[1] = inBuffer[15 + i * 10] * 256 + inBuffer[16 + i * 10];
            strcat(HTMLString, "ctx.beginPath();\r\n");
            strcat(HTMLString, "ctx.strokeStyle = \"#008000\";\r\n"); //цвет линий
            strcat(HTMLString, "ctx.setLineDash([10]);\r\n");
            sprintf(HTMLString + strlen(HTMLString),"ctx.moveTo(s,(%d + %d)*kY+s);\r\n", (-1)*val_DWord.Value, maxY);
            sprintf(HTMLString + strlen(HTMLString),"ctx.lineTo(%d*kX+s,(%d + %d)*kY+s);\r\n", maxX, (-1)*val_DWord.Value, maxY);
            strcat(HTMLString, "ctx.stroke();\r\n");
            sprintf(HTMLString + strlen(HTMLString),"ctx.fillText(%d,s+2,(%d + %d)*kY+s-2);\r\n",val_DWord.Value, (-1)*val_DWord.Value, maxY); 
            break;
         case T_REAL:
            val_Float.Word[0] = inBuffer[9 + i * 10] * 256 + inBuffer[10 + i * 10];
            val_Float.Word[1] = inBuffer[11 + i * 10] * 256 + inBuffer[12 + i * 10];
            strcat(HTMLString, "ctx.beginPath();\r\n");
            strcat(HTMLString, "ctx.strokeStyle = \"#008000\";\r\n"); //цвет линий
            strcat(HTMLString, "ctx.setLineDash([10]);\r\n");
            sprintf(HTMLString + strlen(HTMLString),"ctx.moveTo(s,(%f + %d)*kY+s);\r\n", (-1)*val_Float.Value, maxY);
            sprintf(HTMLString + strlen(HTMLString),"ctx.lineTo(%d*kX+s,(%f + %d)*kY+s);\r\n", maxX, (-1)*val_Float.Value, maxY);
            strcat(HTMLString, "ctx.stroke();\r\n");
            
            sprintf(HTMLString + strlen(HTMLString),"ctx.fillText(%f,s+2,(%f + %d)*kY+s-2);\r\n",val_Float.Value, (-1)*val_Float.Value, maxY);
            val_Float.Word[0] = inBuffer[13 + i * 10] * 256 + inBuffer[14 + i * 10];
            val_Float.Word[1] = inBuffer[15 + i * 10] * 256 + inBuffer[16 + i * 10];
            strcat(HTMLString, "ctx.beginPath();\r\n");
            strcat(HTMLString, "ctx.strokeStyle = \"#008000\";\r\n"); //цвет линий
            strcat(HTMLString, "ctx.setLineDash([10]);\r\n");
            sprintf(HTMLString + strlen(HTMLString),"ctx.moveTo(s,(%f + %d)*kY+s);\r\n", (-1)*val_Float.Value, maxY);
            sprintf(HTMLString + strlen(HTMLString),"ctx.lineTo(%d*kX+s,(%f + %d)*kY+s);\r\n", maxX, (-1)*val_Float.Value, maxY);
            strcat(HTMLString, "ctx.stroke();\r\n");
            sprintf(HTMLString + strlen(HTMLString),"ctx.fillText(%f,s+2,(%f + %d)*kY+s-2);\r\n",val_Float.Value, (-1)*val_Float.Value, maxY); 
            break;
        };
        break;
     case D_POINT:
        switch (inBuffer[7 + i * 10])
        {  
         case T_INT:
            strcat(HTMLString, "ctx.beginPath();\r\n");
            strcat(HTMLString, "ctx.strokeStyle = \"#800080\";\r\n"); //цвет линий
            strcat(HTMLString, "ctx.fillStyle = \"#800080\";\r\n"); //цвет заливки
	    sprintf(HTMLString + strlen(HTMLString),"ctx.fillRect(%d*kX+s, (%d + %d)*kY+s, 4, 4);\r\n",  
              (int16_t)(inBuffer[9 + i * 10] * 256 + inBuffer[10 + i * 10]), 
              (-1)*(int16_t)(inBuffer[13 + i * 10] * 256 + inBuffer[14 + i * 10]), maxY);
	    strcat(HTMLString, "ctx.fill();\r\n");
            strcat(HTMLString, "ctx.stroke();\r\n");
            break;
         case T_UINT:
            strcat(HTMLString, "ctx.beginPath();\r\n");
            strcat(HTMLString, "ctx.strokeStyle = \"#800080\";\r\n"); //цвет линий
            strcat(HTMLString, "ctx.fillStyle = \"#800080\";\r\n"); //цвет заливки
            //sprintf(HTMLString + strlen(HTMLString),"ctx.arc(%d*kX+s, (%d + %d)*kY+s, 2, -Math.PI, Math.PI, true);\r\n",
	    sprintf(HTMLString + strlen(HTMLString),"ctx.fillRect(%d*kX+s, (%d + %d)*kY+s, 4, 4);\r\n", 
              inBuffer[9 + i * 10] * 256 + inBuffer[10 + i * 10], 
              (-1)*(inBuffer[13 + i * 10] * 256 + inBuffer[14 + i * 10]), maxY);
	    strcat(HTMLString, "ctx.fill();\r\n");
            strcat(HTMLString, "ctx.stroke();\r\n");
            break;
         case T_DINT:
            strcat(HTMLString, "ctx.beginPath();\r\n");
            strcat(HTMLString, "ctx.strokeStyle = \"#800080\";\r\n"); //цвет линий
            strcat(HTMLString, "ctx.fillStyle = \"#800080\";\r\n"); //цвет заливки
            val_Integer.Word[0] = inBuffer[9 + i * 10] * 256 + inBuffer[10 + i * 10];
            val_Integer.Word[1] = inBuffer[11 + i * 10] * 256 + inBuffer[12 + i * 10]; 
	    sprintf(HTMLString + strlen(HTMLString),"ctx.fillRect(%d*kX+s,",val_Integer.Value); 
            val_Integer.Word[0] = inBuffer[13 + i * 10] * 256 + inBuffer[14 + i * 10];
            val_Integer.Word[1] = inBuffer[15 + i * 10] * 256 + inBuffer[16 + i * 10]; 
            sprintf(HTMLString + strlen(HTMLString),"(%d + %d)*kY+s, 4, 4);\r\n",(-1)*val_Integer.Value, maxY); 
	    strcat(HTMLString, "ctx.fill();\r\n");
            strcat(HTMLString, "ctx.stroke();\r\n");
            break;
         case T_UDINT:
            strcat(HTMLString, "ctx.beginPath();\r\n");
            strcat(HTMLString, "ctx.strokeStyle = \"#800080\";\r\n"); //цвет линий
            strcat(HTMLString, "ctx.fillStyle = \"#800080\";\r\n"); //цвет заливки
            val_DWord.Word[0] = inBuffer[9 + i * 10] * 256 + inBuffer[10 + i * 10];
            val_DWord.Word[1] = inBuffer[11 + i * 10] * 256 + inBuffer[12 + i * 10]; 
	    sprintf(HTMLString + strlen(HTMLString),"ctx.fillRect(%d*kX+s,",val_DWord.Value); 
            val_DWord.Word[0] = inBuffer[13 + i * 10] * 256 + inBuffer[14 + i * 10];
            val_DWord.Word[1] = inBuffer[15 + i * 10] * 256 + inBuffer[16 + i * 10]; 
            sprintf(HTMLString + strlen(HTMLString),"(%d + %d)*kY+s, 4, 4);\r\n",(-1)*val_DWord.Value, maxY); 
	    strcat(HTMLString, "ctx.fill();\r\n");
            strcat(HTMLString, "ctx.stroke();\r\n");
            break;
         case T_REAL:
            strcat(HTMLString, "ctx.beginPath();\r\n");
            strcat(HTMLString, "ctx.strokeStyle = \"#800080\";\r\n"); //цвет линий
            strcat(HTMLString, "ctx.fillStyle = \"#800080\";\r\n"); //цвет заливки
            val_Float.Word[0] = inBuffer[9 + i * 10] * 256 + inBuffer[10 + i * 10];
            val_Float.Word[1] = inBuffer[11 + i * 10] * 256 + inBuffer[12 + i * 10]; 
	    sprintf(HTMLString + strlen(HTMLString),"ctx.fillRect(%f*kX+s,",val_Float.Value); 
            val_Float.Word[0] = inBuffer[13 + i * 10] * 256 + inBuffer[14 + i * 10];
            val_Float.Word[1] = inBuffer[15 + i * 10] * 256 + inBuffer[16 + i * 10]; 
            sprintf(HTMLString + strlen(HTMLString),"(%f + %d)*kY+s, 4, 4);\r\n",(-1)*val_Float.Value, maxY); 
	    strcat(HTMLString, "ctx.fill();\r\n");
            strcat(HTMLString, "ctx.stroke();\r\n");            
            break;
        };
        break; 
     case D_POINT_STAR:
        strcat(HTMLString, "ctx.font = \"20px Arial\";\r\n");
        strcat(HTMLString, "ctx.strokeStyle = \"#000000\";\r\n"); //цвет линий
        strcat(HTMLString, "ctx.fillStyle = \"#000000\";\r\n"); //цвет заливки
       
        switch (inBuffer[7 + i * 10])
        {  
         case T_INT:
            sprintf(HTMLString + strlen(HTMLString),"ctx.fillText(\"*\",%d*kX+s,(%d + %d)*kY+s);\r\n",
                    (int16_t)(inBuffer[9 + i * 10] * 256 + inBuffer[10 + i * 10]), 
                    (-1)*(int16_t)(inBuffer[13 + i * 10] * 256 + inBuffer[14 + i * 10]), maxY);
            break;
         case T_UINT:
            sprintf(HTMLString + strlen(HTMLString),"ctx.fillText(\"*\",%d*kX+s,(%d + %d)*kY+s);\r\n",
                    inBuffer[9 + i * 10] * 256 + inBuffer[10 + i * 10], 
                    (-1)*(inBuffer[13 + i * 10] * 256 + inBuffer[14 + i * 10]), maxY);
            break;
         case T_DINT:
            val_Integer.Word[0] = inBuffer[9 + i * 10] * 256 + inBuffer[10 + i * 10];
            val_Integer.Word[1] = inBuffer[11 + i * 10] * 256 + inBuffer[12 + i * 10]; 
	    sprintf(HTMLString + strlen(HTMLString),"ctx.fillText(\"*\",%d*kX+s,",val_Integer.Value);
            val_Integer.Word[0] = inBuffer[13 + i * 10] * 256 + inBuffer[14 + i * 10];
            val_Integer.Word[1] = inBuffer[15 + i * 10] * 256 + inBuffer[16 + i * 10]; 
            sprintf(HTMLString + strlen(HTMLString),"(%d + %d)*kY+s);\r\n",(-1)*val_Integer.Value, maxY); 
	    break;
         case T_UDINT:
            val_DWord.Word[0] = inBuffer[9 + i * 10] * 256 + inBuffer[10 + i * 10];
            val_DWord.Word[1] = inBuffer[11 + i * 10] * 256 + inBuffer[12 + i * 10]; 
	    sprintf(HTMLString + strlen(HTMLString),"ctx.fillText(\"*\",%d*kX+s,",val_DWord.Value);
            val_DWord.Word[0] = inBuffer[13 + i * 10] * 256 + inBuffer[14 + i * 10];
            val_DWord.Word[1] = inBuffer[15 + i * 10] * 256 + inBuffer[16 + i * 10]; 
            sprintf(HTMLString + strlen(HTMLString),"(%d + %d)*kY+s);\r\n",(-1)*val_DWord.Value, maxY); 
            break;
         case T_REAL:
            val_Float.Word[0] = inBuffer[9 + i * 10] * 256 + inBuffer[10 + i * 10];
            val_Float.Word[1] = inBuffer[11 + i * 10] * 256 + inBuffer[12 + i * 10]; 
	    sprintf(HTMLString + strlen(HTMLString),"ctx.fillText(\"*\",%f*kX+s,",val_Float.Value);
            val_Float.Word[0] = inBuffer[13 + i * 10] * 256 + inBuffer[14 + i * 10];
            val_Float.Word[1] = inBuffer[15 + i * 10] * 256 + inBuffer[16 + i * 10]; 
            sprintf(HTMLString + strlen(HTMLString),"(%f + %d)*kY+s);\r\n",(-1)*val_Float.Value, maxY);             break;
        };
        strcat(HTMLString, "ctx.font = \"14px Arial\";\r\n");
        break;        
     };
  };
};

char CreatPageForBrowserDyn(int aIndex)
{
    int i;
    uint16_t byteSize;
    uint16_t x, y, maxX = 0, maxY = 0, minX = 0xFFFF, minY = 0xFFFF;
    float rY;
    
    ClearHTMLString();
    
    copy_P(HTMLString, AnswerDyn_1);
    
    outBuffer[0] = 4;
    outBuffer[1] = (uint8_t)(PItem.Adres >> 8); 
    outBuffer[2] = (uint8_t)(PItem.Adres & 0xFF);  
    outBuffer[3] = (uint8_t)(PItem.BitFieldCount >> 8);
    outBuffer[4] = (uint8_t)(PItem.BitFieldCount & 0xFF);
   
    if (modbusRegistersEdit(outBuffer, inBuffer, 1, &byteSize) != 0)
        return 0;
    // Преобразуем время в string
    val_DWord.Word[0] = inBuffer[3] * 256 + inBuffer[4];
    val_DWord.Word[1] = inBuffer[5] * 256 + inBuffer[6];
    convert_unix_2_date(val_DWord.Value); 
    
    ValStr[0] = (u_2_date/10) + 0x30;
    ValStr[1] = (u_2_date%10) + 0x30;
    ValStr[2] = '.';
    ValStr[3] = (u_2_month/10) + 0x30;
    ValStr[4] = (u_2_month%10) + 0x30;
    ValStr[5] = '.';
    ValStr[6] = '2';
    ValStr[7] = '0';
    ValStr[8] = (u_2_year/10) + 0x30;
    ValStr[9] = (u_2_year%10) + 0x30;
    ValStr[10] = ' ';        
    ValStr[11] = (u_2_hor/10) + 0x30;
    ValStr[12] = (u_2_hor%10) + 0x30;
    ValStr[13] = ':';
    ValStr[14] = (u_2_min/10) + 0x30;
    ValStr[15] = (u_2_min%10) + 0x30;
    ValStr[16] = ':';
    ValStr[17] = (u_2_sec/10) + 0x30; 
    ValStr[18] = (u_2_sec%10) + 0x30; 
    ValStr[19] = ' ';
    ValStr[20] = 0;    
    
    //Ищем максимальное значение по х, у и min по y
    for (i = 0; i < 200; i++)
    {
      
      x = inBuffer[57 + i * 4] * 256 + inBuffer[58 + i * 4];
      y = inBuffer[59 + i * 4] * 256 + inBuffer[60 + i * 4];
      if (x > maxX)
        maxX = x;
      
      if (x < minX)
        minX = x;      
      
      if (y > maxY)
        maxY = y;
       
      if (y < minY)
        minY = y;      
    };
    
    rY = GetMaxY();
    if (rY > maxY)
      maxY = (uint16_t)rY;
    //sprintf(HTMLString + strlen(HTMLString),"if (example.height/(%d+s) > example.width/(%d+s))\r\n", maxY, maxX);
    //sprintf(HTMLString + strlen(HTMLString),"k = (example.width-s)/(%d+s)\r\n", maxX);
    //strcat(HTMLString, "else\r\n");
    //sprintf(HTMLString + strlen(HTMLString),"k = (example.height-s)/(%d+s);\r\n", maxY);
    
    sprintf(HTMLString + strlen(HTMLString),"kX = (example.width-s)/(%d+s+10)\r\n", maxX);
    sprintf(HTMLString + strlen(HTMLString),"kY = (example.height-s)/(%d+s+10);\r\n", maxY);
    
    sprintf(HTMLString + strlen(HTMLString),"maxY=%d;\r\n", maxY);
    sprintf(HTMLString + strlen(HTMLString),"minY=%d;\r\n", minY);
    sprintf(HTMLString + strlen(HTMLString),"maxX=%d;\r\n", maxX);
    sprintf(HTMLString + strlen(HTMLString),"minX=%d;\r\n", minX);
    
    strcat(HTMLString, "ctx.font = \"14px Arial\";\r\n");
    
    strcat(HTMLString, "ctx.beginPath();\r\n");

    x = inBuffer[57] * 256 + inBuffer[58];
    y = inBuffer[59] * 256 + inBuffer[60];
    //****************
                        
    sprintf(HTMLString + strlen(HTMLString),"ctx.moveTo(%d*k+s,(%d + %d)*k+s);\r\n", x, (-1)*y, maxY);
    for (i = 1; i < 200; i++)
    {
          
      x = inBuffer[57 + i * 4] * 256 + inBuffer[58 + i * 4];
      y = inBuffer[59 + i * 4] * 256 + inBuffer[60 + i * 4];
      sprintf(HTMLString + strlen(HTMLString),"ctx.lineTo(%d*kX+s,(%d + %d)*kY+s);\r\n", x,(-1)*y, maxY); 
      
    };
    strcat(HTMLString, "ctx.stroke();\r\n");
    //Рисуем ось Y
    strcat(HTMLString, "ctx.beginPath();\r\n");
    strcat(HTMLString, "ctx.moveTo(s,5);\r\n");
    sprintf(HTMLString + strlen(HTMLString),"ctx.lineTo(s,%d*kY+s);\r\n", maxY);
    strcat(HTMLString, "ctx.stroke();\r\n");
    
    //Рисуем ось X
    strcat(HTMLString, "ctx.beginPath();\r\n");
    sprintf(HTMLString + strlen(HTMLString),"ctx.moveTo(s,%d*kY+s);\r\n", maxY);
    sprintf(HTMLString + strlen(HTMLString),"ctx.lineTo(example.width-s,%d*kY+s);\r\n",maxY);
    strcat(HTMLString, "ctx.stroke();\r\n");
        
    //Рисуем линию max Y и текст
    strcat(HTMLString, "ctx.beginPath();\r\n");
    strcat(HTMLString, "ctx.strokeStyle = \"#ff0000\";\r\n"); //цвет линий
    strcat(HTMLString, "ctx.setLineDash([10]);\r\n");
    sprintf(HTMLString + strlen(HTMLString),"ctx.moveTo(s,(%d + %d)*kY+s);\r\n", (-1)*maxY, maxY);
    sprintf(HTMLString + strlen(HTMLString),"ctx.lineTo(%d*kX+s,(%d + %d)*kY+s);\r\n", minX, (-1)*maxY, maxY);
    strcat(HTMLString, "ctx.stroke();\r\n");
    sprintf(HTMLString + strlen(HTMLString),"ctx.fillText(%d,s+2,(%d + %d)*kY+s-2);\r\n",maxY, (-1)*maxY, maxY); 
    
    //Рисуем линию min Y и текст
    strcat(HTMLString, "ctx.beginPath();\r\n");
    strcat(HTMLString, "ctx.strokeStyle = \"#ff0000\";\r\n"); //цвет линий
    strcat(HTMLString, "ctx.setLineDash([10]);\r\n");
    sprintf(HTMLString + strlen(HTMLString),"ctx.moveTo(s,(%d + %d)*kY+s);\r\n", (-1)*minY, maxY);
    sprintf(HTMLString + strlen(HTMLString),"ctx.lineTo(%d*kX+s,(%d + %d)*kY+s);\r\n", minX, (-1)*minY, maxY);
    strcat(HTMLString, "ctx.stroke();\r\n");
    sprintf(HTMLString + strlen(HTMLString),"ctx.fillText(%d,s+2,(%d + %d)*kY+s-2);\r\n",minY, (-1)*minY, maxY);
    
    //Рисуем время
    sprintf(HTMLString + strlen(HTMLString),"ctx.fillText(\"%s\",%d,%d);\r\n",ValStr, 100, 10);
    DrawLine(maxX, maxY);
    copy_P(HTMLString + strlen(HTMLString), AnswerDyn_2);
    
    return 1;
}
char CreatPageForBrowserWat(int aIndex)
{
    int i;
    uint16_t byteSize;
    uint16_t x, maxX = 0, maxY = 0, minX = 0xFFFF;
    int16_t y, minY = 0xFFFF, offset;  
    char mult;
    
    ClearHTMLString();
    
    copy_P(HTMLString, AnswerDyn_1);
    
    outBuffer[0] = 4;
    outBuffer[1] = (uint8_t)(PItem.Adres >> 8); 
    outBuffer[2] = (uint8_t)(PItem.Adres & 0xFF);  
    outBuffer[3] = (uint8_t)(PItem.BitFieldCount >> 8);
    outBuffer[4] = (uint8_t)(PItem.BitFieldCount & 0xFF);
   
    if (modbusRegistersEdit(outBuffer, inBuffer, 1, &byteSize) != 0)
        return 0;
    if (PItem.BitFieldStart == 255)
      mult = 1;
    else
      mult = PItem.BitFieldStart;
    //Ищем максимальное значение по х, у и min по y
    for (i = 0; i < 200; i++)
    {
      
      y = (inBuffer[3 + i * 2] * 256 + inBuffer[4 + i * 2]) * mult;
      
     
      if (y > maxY)
        maxY = y;
       
      if (y < minY)
        minY = y;      
    };
    maxX = 199;
    minX = 0;
    
    if (minY < 0)
      offset = minY;
    else
      offset = 0;
    
    sprintf(HTMLString + strlen(HTMLString),"kX = (example.width-s)/(%d+s+10)\r\n", maxX);
    sprintf(HTMLString + strlen(HTMLString),"kY = (example.height-s)/(%d+s+10);\r\n", maxY - offset);
    
    sprintf(HTMLString + strlen(HTMLString),"maxY=%d;\r\n", maxY);
    sprintf(HTMLString + strlen(HTMLString),"minY=%d;\r\n", minY);
    sprintf(HTMLString + strlen(HTMLString),"maxX=%d;\r\n", maxX);
    sprintf(HTMLString + strlen(HTMLString),"minX=%d;\r\n", minX);
    
    strcat(HTMLString, "ctx.font = \"14px Arial\";\r\n");
    
    strcat(HTMLString, "ctx.beginPath();\r\n");

    x = 0;
    y = (inBuffer[3] * 256 + inBuffer[4]) * mult;
    //****************
                        
    sprintf(HTMLString + strlen(HTMLString),"ctx.moveTo(%d*k+s,(%d + %d)*k+s);\r\n", x, (-1)*y, maxY);
    for (i = 1; i < 200; i++)
    {
          
      x = i;
      y = (inBuffer[3 + i * 2] * 256 + inBuffer[4 + i * 2]) * mult;
      sprintf(HTMLString + strlen(HTMLString),"ctx.lineTo(%d*kX+s,(%d + %d)*kY+s);\r\n", x,(-1)*y, maxY); 
      
    };
    strcat(HTMLString, "ctx.stroke();\r\n");
    //Рисуем ось Y
    strcat(HTMLString, "ctx.beginPath();\r\n");
    strcat(HTMLString, "ctx.moveTo(s,5);\r\n");
    sprintf(HTMLString + strlen(HTMLString),"ctx.lineTo(s,%d*kY+s);\r\n", maxY);
    strcat(HTMLString, "ctx.stroke();\r\n");
    
    //Рисуем ось X
    strcat(HTMLString, "ctx.beginPath();\r\n");
    sprintf(HTMLString + strlen(HTMLString),"ctx.moveTo(s,%d*kY+s);\r\n", maxY);
    sprintf(HTMLString + strlen(HTMLString),"ctx.lineTo(%d*kX+s,%d*kY+s);\r\n",maxX, maxY);
    strcat(HTMLString, "ctx.stroke();\r\n");
    
    //Рисуем линию max Y и текст
    strcat(HTMLString, "ctx.beginPath();\r\n");
    strcat(HTMLString, "ctx.strokeStyle = \"#ff0000\";\r\n"); //цвет линий
    strcat(HTMLString, "ctx.setLineDash([10]);\r\n");
    sprintf(HTMLString + strlen(HTMLString),"ctx.moveTo(s,(%d + %d)*kY+s);\r\n", (-1)*maxY, maxY);
    sprintf(HTMLString + strlen(HTMLString),"ctx.lineTo(%d*kX+s,(%d + %d)*kY+s);\r\n", maxX, (-1)*maxY, maxY);
    strcat(HTMLString, "ctx.stroke();\r\n");
    sprintf(HTMLString + strlen(HTMLString),"ctx.fillText(%d,s+2,(%d + %d)*kY+s-2);\r\n",maxY, (-1)*maxY, maxY); 
    
    //Рисуем линию min Y и текст
    strcat(HTMLString, "ctx.beginPath();\r\n");
    strcat(HTMLString, "ctx.strokeStyle = \"#ff0000\";\r\n"); //цвет линий
    strcat(HTMLString, "ctx.setLineDash([10]);\r\n");
    sprintf(HTMLString + strlen(HTMLString),"ctx.moveTo(s,(%d + %d)*kY+s);\r\n", (-1)*minY, maxY);
    sprintf(HTMLString + strlen(HTMLString),"ctx.lineTo(%d*kX+s,(%d + %d)*kY+s);\r\n", maxX, (-1)*minY, maxY);
    strcat(HTMLString, "ctx.stroke();\r\n");
    sprintf(HTMLString + strlen(HTMLString),"ctx.fillText(%d,s+2,(%d + %d)*kY+s-2);\r\n",minY, (-1)*minY, maxY);
    

    copy_P(HTMLString + strlen(HTMLString), AnswerDyn_2);
    
    return 1;
}
// страница с архивами для браузера
char CreatPageForBrowser_2(int aIndex)
{
    uint16_t i;
    uint16_t temp;
    char qw;
    // если пункт меню текущий то читаем последний индекс
    if (aIndex == 2)
        FlagReadLastArhiveIndex = 0;
    
    if (FlagReadLastArhiveIndex == 0)
    {
        LastArhiveIndex = GetLastIndexArhive();
        if (LastArhiveIndex < 0)
            return 0;
        CurrentArhiveIndex = LastArhiveIndex;
        FlagReadLastArhiveIndex = 1;
        //if (LastArhiveIndex == 0) 
        //  CurrentArhiveIndex = MAX_ARHIVE_STACK - 1;
        //else
        //  CurrentArhiveIndex = LastArhiveIndex - 1;
    };
       
    
    ClearHTMLString();

    
    if (ColorHtmlText == 0)
      copy_P(HTMLString, html_text_black);
    else
      copy_P(HTMLString, html_text_blue);

    //copy_P(HTMLString + strlen(HTMLString), html_method_get_1);
    //sprintf(HTMLString + strlen(HTMLString), "%d", aIndex);
    //copy_P(HTMLString + strlen(HTMLString), html_method_get_2);
        
    for (i = 0; i <= MAX_ARHIVE_STR - 1; i++)
    {
       CurrentMenu = 2;
       temp= ReadDataFromArhive(ValStr, aIndex,&qw);
       if(qw==0) continue;  // 
       copy_P(HTMLString + strlen(HTMLString), html_text_1);
       sprintf(HTMLString + strlen(HTMLString), "%d", temp);
       copy_P(HTMLString + strlen(HTMLString), html_text_2);
       sprintf(HTMLString + strlen(HTMLString), "%s", ValStr);
       decodArhiv(ValData[5]);
       copy_P(HTMLString + strlen(HTMLString), html_text_3);
 
    };
    copy_P(HTMLString + strlen(HTMLString), html_end_2);
    
    return 1;
};

void CreateHead(char *aString)
{/*
    // Создаем заголовок с длиной пакета
    copy_P(sAddHead, AnswerHead);
    sprintf(head, "%s%d\r\n\r\n", sAddHead, strlen(aString));
 */   
};
// Добавляет заголовок
void AddHead(char *aString, char a)
{
  /*
    int i, n;
    
    // Создаем заголовок с длиной пакета
    copy_P(sAddHead, AnswerHead);
    sprintf(head, "%s%d\r\n\r\n", sAddHead, strlen(aString));
    
    // если а = 0 то aString не HTMLString и можно просто присоеденить
    if (a == 0)
    {
        sprintf(HTMLString, "%s%s\r\n", head, aString);
        return;
    };
    //Если aString это HTMLString           
    //длина заголовка вместе с длиной пакет
    n = strlen(head);
    
    ShiftToRight(aString, n);
    
    for (i = 0; i < n; i++ )
        aString[i] = head[i];
  */  
};

void ShiftToRight(char *aString, int aCount)
{
    int i;
    
    for (i = strlen(aString) - 1; i >= 0; i--)
        aString[i + aCount] = aString[i];

};

void DoHTML(int aAnswerID, char *inBuf, unsigned int *aSize)
{
    int i;
    for (i = 0; i < 2048; i++)
        inBuf[i] = 0;
    
    switch (aAnswerID)
    {
    case PAGE_OK:
        sprintf (inBuf , "%s", HTMLString);
        break;
    case PAGE_MAIN:
        sprintf(inBuf, "%s", HTMLString);
        break;
    case PAGE_MAIN_MENU:
        sprintf(inBuf, "%s", HTMLString);
        break;
    case PAGE_MENU:
        sprintf(inBuf, "%s", HTMLString);
        break;
    case PAGE_MENU_1:
        sprintf(inBuf, "%s", HTMLString);
        break;        
    case PAGE_MENU_ARHIVE:
        sprintf(inBuf, "%s", HTMLString);
        break;           
    case PAGE_ERROR:
        sprintf (inBuf , "%s", HTMLString);
        break;
    case PAGE_ERROR_500:
        sprintf (inBuf , "%s", HTMLString);
        break;
        
    default:
        if (strlen(HTMLString) < MAX_SIZE_ONE_HTML_PACKET)
          sprintf(inBuf, "%s", HTMLString);
        else
        {
          for (i = 0; i < MAX_SIZE_ONE_HTML_PACKET; i++)
            inBuf[i] = HTMLString[i];
        }
        break;
    };
    
    *aSize = strlen(inBuf);

};

void convert_unix_2_date( unsigned long int time_sec)
{
   unsigned char dobavka;
   
   u_2_sec = time_sec%60;
   time_sec = time_sec/60;
   u_2_min = time_sec%60;
   time_sec = time_sec/60;  // остались часы
   u_2_hor = time_sec%24; 
   time_sec = time_sec/24;  // это дни начиная с 2000 года
   u_2_year = (time_sec/1461)*4;
   time_sec = time_sec%1461;
   time_sec++;
   if ( time_sec <=366) 
   {
     dobavka = 1;
     goto visok;
   }
   else 
     dobavka = 0;
   
   u_2_year = u_2_year + 1;
   time_sec = time_sec - 366;
   u_2_year = u_2_year + (time_sec/365);
   
   if ( (time_sec%365) == 0) 
   { 
     u_2_year = u_2_year - 1; 
     time_sec = 365; 
   }
   else 
     time_sec = time_sec%365;
   
visok:   
   
   if (time_sec <= 31)           
   {
     u_2_month = 1;
     u_2_date = time_sec;
     return;
   }
   time_sec = time_sec - 31;
   
   if (time_sec <= (28 + dobavka)) 
   {
     u_2_month = 2;
     u_2_date = time_sec;
     return;
   }
   time_sec = time_sec - (28 + dobavka);
   
   if (time_sec <= 31)          
   {
     u_2_month = 3;
     u_2_date = time_sec;
      return;
   }
   time_sec = time_sec - 31;
    
   if (time_sec <= 30)          
   {
     u_2_month = 4;
     u_2_date = time_sec;
     return;
   }
   time_sec = time_sec - 30;
    
   if (time_sec <= 31)          
   {
     u_2_month=5;
     u_2_date = time_sec;
     return;
   }
   time_sec=time_sec-31;
    
   if (time_sec <= 30)          
   {
     u_2_month = 6;
     u_2_date = time_sec;
     return;
   }
   time_sec = time_sec - 30;
   
   if (time_sec <= 31)          
   { 
     u_2_month = 7;
     u_2_date = time_sec;
     return;
   }
   time_sec=time_sec - 31;
     
   if (time_sec <= 31)          
   {
     u_2_month = 8;
     u_2_date = time_sec;
     return;
   }
   time_sec=time_sec-31;
     
   if (time_sec <= 30)           
   {
     u_2_month = 9;
     u_2_date = time_sec;
     return;
   }
   time_sec = time_sec - 30;
     
     
   if (time_sec <= 31)          
   {
     u_2_month = 10;
     u_2_date = time_sec;
     return;
   }
   time_sec = time_sec - 31;
    
   if (time_sec <= 30)            
   { 
     u_2_month = 11;
     u_2_date = time_sec;
     return;
   }
   time_sec=time_sec-30;
   
   if (time_sec <= 31)           
   {
     u_2_month = 12;
     u_2_date = time_sec;
     return;
   }
     
}

/*
void decodArhiv(int aCode)
{
  
  int8_t *pa;
  pa = (int8_t *)&ValData[0];
  
switch(aCode)  
{
  
case 1:
             copy_P(HTMLString + strlen(HTMLString), AVAR_1);
             copy_P(HTMLString + strlen(HTMLString), html_br);
             copy_P(HTMLString + strlen(HTMLString), AVAR_1_4);
             sprintf(HTMLString + strlen(HTMLString), "%d", pa[4]);
             copy_P(HTMLString + strlen(HTMLString), html_br);  
             copy_P(HTMLString + strlen(HTMLString), AVAR_1_5);
             sprintf(HTMLString + strlen(HTMLString), "%d", pa[5]);
             copy_P(HTMLString + strlen(HTMLString), html_br);
             copy_P(HTMLString + strlen(HTMLString), AVAR_1_6);
             sprintf(HTMLString + strlen(HTMLString), "%d", pa[6]);
             copy_P(HTMLString + strlen(HTMLString), html_br);
             copy_P(HTMLString + strlen(HTMLString), AVAR_1_7);
             sprintf(HTMLString + strlen(HTMLString), "%d", pa[7]);
             copy_P(HTMLString + strlen(HTMLString), html_br);
             copy_P(HTMLString + strlen(HTMLString), AVAR_1_8);
             sprintf(HTMLString + strlen(HTMLString), "%d", pa[8] * 10);
             copy_P(HTMLString + strlen(HTMLString), html_br);
             copy_P(HTMLString + strlen(HTMLString), AVAR_1_9);
             sprintf(HTMLString + strlen(HTMLString), "%d", pa[9]);
             copy_P(HTMLString + strlen(HTMLString), html_br);         
             break;
case 2:
             copy_P(HTMLString + strlen(HTMLString), AVAR_2 );
             copy_P(HTMLString + strlen(HTMLString), html_br);
             copy_P(HTMLString + strlen(HTMLString), AVAR_1_4);
             sprintf(HTMLString + strlen(HTMLString), "%d", pa[4]);
             copy_P(HTMLString + strlen(HTMLString), html_br);  
             copy_P(HTMLString + strlen(HTMLString), AVAR_1_5);
             sprintf(HTMLString + strlen(HTMLString), "%d", pa[5]);
             copy_P(HTMLString + strlen(HTMLString), html_br);
             copy_P(HTMLString + strlen(HTMLString), AVAR_1_6);
             sprintf(HTMLString + strlen(HTMLString), "%d", pa[6]);
             copy_P(HTMLString + strlen(HTMLString), html_br);
             copy_P(HTMLString + strlen(HTMLString), AVAR_1_7);
             sprintf(HTMLString + strlen(HTMLString), "%d", pa[7]);
             copy_P(HTMLString + strlen(HTMLString), html_br);
             copy_P(HTMLString + strlen(HTMLString), AVAR_1_8);
             sprintf(HTMLString + strlen(HTMLString), "%d", pa[8] * 10);
             copy_P(HTMLString + strlen(HTMLString), html_br);
             copy_P(HTMLString + strlen(HTMLString), AVAR_1_9);
             sprintf(HTMLString + strlen(HTMLString), "%d", pa[9]);
             copy_P(HTMLString + strlen(HTMLString), html_br);         
             break;
case 3:
             copy_P(HTMLString + strlen(HTMLString), AVAR_3 );
             copy_P(HTMLString + strlen(HTMLString), html_br);
             copy_P(HTMLString + strlen(HTMLString), AVAR_1_4);
             sprintf(HTMLString + strlen(HTMLString), "%d", pa[4]);
             copy_P(HTMLString + strlen(HTMLString), html_br);  
             copy_P(HTMLString + strlen(HTMLString), AVAR_1_5);
             sprintf(HTMLString + strlen(HTMLString), "%d", pa[5]);
             copy_P(HTMLString + strlen(HTMLString), html_br);
             copy_P(HTMLString + strlen(HTMLString), AVAR_1_6);
             sprintf(HTMLString + strlen(HTMLString), "%d", pa[6]);
             copy_P(HTMLString + strlen(HTMLString), html_br);
             copy_P(HTMLString + strlen(HTMLString), AVAR_1_7);
             sprintf(HTMLString + strlen(HTMLString), "%d", pa[7]);
             copy_P(HTMLString + strlen(HTMLString), html_br);
             copy_P(HTMLString + strlen(HTMLString), AVAR_1_8);
             sprintf(HTMLString + strlen(HTMLString), "%d", pa[8] * 10);
             copy_P(HTMLString + strlen(HTMLString), html_br);
             copy_P(HTMLString + strlen(HTMLString), AVAR_1_9);
             sprintf(HTMLString + strlen(HTMLString), "%d", pa[9]);
             copy_P(HTMLString + strlen(HTMLString), html_br);         
             break;

case 4:
             copy_P(HTMLString + strlen(HTMLString), AVAR_4 );
             copy_P(HTMLString + strlen(HTMLString), html_br);  
             copy_P(HTMLString + strlen(HTMLString), AVAR_4_5);
             sprintf(HTMLString + strlen(HTMLString), "%d", pa[5]);
             copy_P(HTMLString + strlen(HTMLString), html_br);
             copy_P(HTMLString + strlen(HTMLString), AVAR_4_6);
             sprintf(HTMLString + strlen(HTMLString), "%d", pa[6]);
             copy_P(HTMLString + strlen(HTMLString), html_br);
             copy_P(HTMLString + strlen(HTMLString), AVAR_1_7);
             sprintf(HTMLString + strlen(HTMLString), "%d", pa[7]);
             copy_P(HTMLString + strlen(HTMLString), html_br);
             copy_P(HTMLString + strlen(HTMLString), AVAR_1_8);
             sprintf(HTMLString + strlen(HTMLString), "%d", pa[8] * 10);
             copy_P(HTMLString + strlen(HTMLString), html_br);
             copy_P(HTMLString + strlen(HTMLString), AVAR_1_9);
             sprintf(HTMLString + strlen(HTMLString), "%d", pa[9]);
             copy_P(HTMLString + strlen(HTMLString), html_br);
             break;
case 5:
             copy_P(HTMLString + strlen(HTMLString), AVAR_5 );
             copy_P(HTMLString + strlen(HTMLString), html_br);
             copy_P(HTMLString + strlen(HTMLString), AVAR_5_4);
             sprintf(HTMLString + strlen(HTMLString), "%d", pa[4]);
             copy_P(HTMLString + strlen(HTMLString), html_br);  
             copy_P(HTMLString + strlen(HTMLString), AVAR_5_5);
             sprintf(HTMLString + strlen(HTMLString), "%d", pa[5]);
             copy_P(HTMLString + strlen(HTMLString), html_br);
             copy_P(HTMLString + strlen(HTMLString), AVAR_5_6);
             sprintf(HTMLString + strlen(HTMLString), "%d", pa[6]);
             copy_P(HTMLString + strlen(HTMLString), html_br);
             copy_P(HTMLString + strlen(HTMLString), AVAR_1_7);
             sprintf(HTMLString + strlen(HTMLString), "%d", pa[7]);
             copy_P(HTMLString + strlen(HTMLString), html_br);
             copy_P(HTMLString + strlen(HTMLString), AVAR_1_8);
             sprintf(HTMLString + strlen(HTMLString), "%d", pa[8] * 10);
             copy_P(HTMLString + strlen(HTMLString), html_br);
             copy_P(HTMLString + strlen(HTMLString), AVAR_1_9);
             sprintf(HTMLString + strlen(HTMLString), "%d", pa[9]);
             copy_P(HTMLString + strlen(HTMLString), html_br);         
             break;
case 6:
             copy_P(HTMLString + strlen(HTMLString), AVAR_6 );
             copy_P(HTMLString + strlen(HTMLString), html_br);
             copy_P(HTMLString + strlen(HTMLString), AVAR_6_4);
             sprintf(HTMLString + strlen(HTMLString), "%d", pa[4]);
             copy_P(HTMLString + strlen(HTMLString), html_br);  
             copy_P(HTMLString + strlen(HTMLString), AVAR_6_5);
             sprintf(HTMLString + strlen(HTMLString), "%d", pa[5]);
             copy_P(HTMLString + strlen(HTMLString), html_br);
             copy_P(HTMLString + strlen(HTMLString), AVAR_6_6);
             sprintf(HTMLString + strlen(HTMLString), "%d", pa[6]);
             copy_P(HTMLString + strlen(HTMLString), html_br);
             copy_P(HTMLString + strlen(HTMLString), AVAR_1_7);
             sprintf(HTMLString + strlen(HTMLString), "%d", pa[7]);
             copy_P(HTMLString + strlen(HTMLString), html_br);
             copy_P(HTMLString + strlen(HTMLString), AVAR_1_8);
             sprintf(HTMLString + strlen(HTMLString), "%d", pa[8] * 10);
             copy_P(HTMLString + strlen(HTMLString), html_br);
             copy_P(HTMLString + strlen(HTMLString), AVAR_6_9);
             sprintf(HTMLString + strlen(HTMLString), "%d", pa[9]);
             copy_P(HTMLString + strlen(HTMLString), html_br);         
             break;
case 7:
             copy_P(HTMLString + strlen(HTMLString), AVAR_7 );
             copy_P(HTMLString + strlen(HTMLString), html_br);
             copy_P(HTMLString + strlen(HTMLString), AVAR_6_4);
             sprintf(HTMLString + strlen(HTMLString), "%d", pa[4]);
             copy_P(HTMLString + strlen(HTMLString), html_br);  
             copy_P(HTMLString + strlen(HTMLString), AVAR_6_5);
             sprintf(HTMLString + strlen(HTMLString), "%d", pa[5]);
             copy_P(HTMLString + strlen(HTMLString), html_br);
             copy_P(HTMLString + strlen(HTMLString), AVAR_6_6);
             sprintf(HTMLString + strlen(HTMLString), "%d", pa[6]);
             copy_P(HTMLString + strlen(HTMLString), html_br);
             copy_P(HTMLString + strlen(HTMLString), AVAR_1_7);
             sprintf(HTMLString + strlen(HTMLString), "%d", pa[7]);
             copy_P(HTMLString + strlen(HTMLString), html_br);
             copy_P(HTMLString + strlen(HTMLString), AVAR_1_8);
             sprintf(HTMLString + strlen(HTMLString), "%d", pa[8] * 10);
             copy_P(HTMLString + strlen(HTMLString), html_br);
             copy_P(HTMLString + strlen(HTMLString), AVAR_6_9);
             sprintf(HTMLString + strlen(HTMLString), "%d", pa[9]);
             copy_P(HTMLString + strlen(HTMLString), html_br); 
             break;
case 8:
             copy_P(HTMLString + strlen(HTMLString), AVAR_8 );
             copy_P(HTMLString + strlen(HTMLString), html_br);
             copy_P(HTMLString + strlen(HTMLString), AVAR_5_4);
             sprintf(HTMLString + strlen(HTMLString), "%d", pa[4]);
             copy_P(HTMLString + strlen(HTMLString), html_br);  
             copy_P(HTMLString + strlen(HTMLString), AVAR_5_5);
             sprintf(HTMLString + strlen(HTMLString), "%d", pa[5]);
             copy_P(HTMLString + strlen(HTMLString), html_br);
             copy_P(HTMLString + strlen(HTMLString), AVAR_5_6);
             sprintf(HTMLString + strlen(HTMLString), "%d", pa[6]);
             copy_P(HTMLString + strlen(HTMLString), html_br);
             copy_P(HTMLString + strlen(HTMLString), AVAR_1_7);
             sprintf(HTMLString + strlen(HTMLString), "%d", pa[7]);
             copy_P(HTMLString + strlen(HTMLString), html_br);
             copy_P(HTMLString + strlen(HTMLString), AVAR_1_8);
             sprintf(HTMLString + strlen(HTMLString), "%d", pa[8] * 10);
             copy_P(HTMLString + strlen(HTMLString), html_br);
             copy_P(HTMLString + strlen(HTMLString), AVAR_1_9);
             sprintf(HTMLString + strlen(HTMLString), "%d", pa[9]);
             copy_P(HTMLString + strlen(HTMLString), html_br);         
             break;
case 9:
             copy_P(HTMLString + strlen(HTMLString), AVAR_9 );
             copy_P(HTMLString + strlen(HTMLString), html_br);
             copy_P(HTMLString + strlen(HTMLString), AVAR_6_4);
             sprintf(HTMLString + strlen(HTMLString), "%d", pa[4]);
             copy_P(HTMLString + strlen(HTMLString), html_br);  
             copy_P(HTMLString + strlen(HTMLString), AVAR_6_5);
             sprintf(HTMLString + strlen(HTMLString), "%d", pa[5]);
             copy_P(HTMLString + strlen(HTMLString), html_br);
             copy_P(HTMLString + strlen(HTMLString), AVAR_6_6);
             sprintf(HTMLString + strlen(HTMLString), "%d", pa[6]);
             copy_P(HTMLString + strlen(HTMLString), html_br);
             copy_P(HTMLString + strlen(HTMLString), AVAR_1_7);
             sprintf(HTMLString + strlen(HTMLString), "%d", pa[7]);
             copy_P(HTMLString + strlen(HTMLString), html_br);
             copy_P(HTMLString + strlen(HTMLString), AVAR_1_8);
             sprintf(HTMLString + strlen(HTMLString), "%d", pa[8] * 10);
             copy_P(HTMLString + strlen(HTMLString), html_br);
             copy_P(HTMLString + strlen(HTMLString), AVAR_9_9);
             sprintf(HTMLString + strlen(HTMLString), "%d", pa[9] * 10);
             copy_P(HTMLString + strlen(HTMLString), html_br);   
             break;
case 10:
             copy_P(HTMLString + strlen(HTMLString), AVAR_10 );
             copy_P(HTMLString + strlen(HTMLString), html_br);
             copy_P(HTMLString + strlen(HTMLString), AVAR_6_4);
             sprintf(HTMLString + strlen(HTMLString), "%d", pa[4]);
             copy_P(HTMLString + strlen(HTMLString), html_br);  
             copy_P(HTMLString + strlen(HTMLString), AVAR_6_5);
             sprintf(HTMLString + strlen(HTMLString), "%d", pa[5]);
             copy_P(HTMLString + strlen(HTMLString), html_br);
             copy_P(HTMLString + strlen(HTMLString), AVAR_6_6);
             sprintf(HTMLString + strlen(HTMLString), "%d", pa[6]);
             copy_P(HTMLString + strlen(HTMLString), html_br);
             copy_P(HTMLString + strlen(HTMLString), AVAR_1_7);
             sprintf(HTMLString + strlen(HTMLString), "%d", pa[7]);
             copy_P(HTMLString + strlen(HTMLString), html_br);
             copy_P(HTMLString + strlen(HTMLString), AVAR_10_8);
             sprintf(HTMLString + strlen(HTMLString), "%d", pa[8] * 10);
             copy_P(HTMLString + strlen(HTMLString), html_br);
             copy_P(HTMLString + strlen(HTMLString), AVAR_10_9);
             sprintf(HTMLString + strlen(HTMLString), "%d", pa[9]);
             copy_P(HTMLString + strlen(HTMLString), html_br);             break;
case 11:
             copy_P(HTMLString + strlen(HTMLString), AVAR_11);
             copy_P(HTMLString + strlen(HTMLString), html_br);  
             copy_P(HTMLString + strlen(HTMLString), AVAR_4_5);
             sprintf(HTMLString + strlen(HTMLString), "%d", pa[5]);
             copy_P(HTMLString + strlen(HTMLString), html_br);
             copy_P(HTMLString + strlen(HTMLString), AVAR_4_6);
             sprintf(HTMLString + strlen(HTMLString), "%d", pa[6]);
             copy_P(HTMLString + strlen(HTMLString), html_br);
             copy_P(HTMLString + strlen(HTMLString), AVAR_1_7);
             sprintf(HTMLString + strlen(HTMLString), "%d", pa[7]);
             copy_P(HTMLString + strlen(HTMLString), html_br);
             copy_P(HTMLString + strlen(HTMLString), AVAR_1_8);
             sprintf(HTMLString + strlen(HTMLString), "%d", pa[8] * 10);
             copy_P(HTMLString + strlen(HTMLString), html_br);
             copy_P(HTMLString + strlen(HTMLString), AVAR_1_9);
             sprintf(HTMLString + strlen(HTMLString), "%d", pa[9]);
             copy_P(HTMLString + strlen(HTMLString), html_br);
             break;
case 12:
             copy_P(HTMLString + strlen(HTMLString), AVAR_12);
             break;
case 13:
             copy_P(HTMLString + strlen(HTMLString), AVAR_13);
              break;
case 14:
             copy_P(HTMLString + strlen(HTMLString), AVAR_14);
             switch (ValData[2])
             {
             case 1:
               copy_P(HTMLString + strlen(HTMLString), AVAR_CHREP);
               break;
             case 2:
               copy_P(HTMLString + strlen(HTMLString), AVAR_KP);
               break;
             case 3:
               copy_P(HTMLString + strlen(HTMLString), AVAR_MANUAL);
               break;
             };
             //sprintf(HTMLString + strlen(HTMLString), "%d", pa[4]);
             break;
case 15:
             copy_P(HTMLString + strlen(HTMLString), AVAR_15);
             switch (ValData[2])
             {
             case 1:
               copy_P(HTMLString + strlen(HTMLString), AVAR_CHREP);
               break;
             case 2:
               copy_P(HTMLString + strlen(HTMLString), AVAR_KP);
               break;
             case 3:
               copy_P(HTMLString + strlen(HTMLString), AVAR_MANUAL);
               break;
             case 4:
               copy_P(HTMLString + strlen(HTMLString), AVAR_CHREP_MODBUS);
               break;               
             };             
             //sprintf(HTMLString + strlen(HTMLString), "%d", pa[4]);
             break;
case 16:
             copy_P(HTMLString + strlen(HTMLString), AVAR_16);
             switch (ValData[2])
             {
             case 1:
               copy_P(HTMLString + strlen(HTMLString), AVAR_TC);
               break;
             case 2:
               copy_P(HTMLString + strlen(HTMLString), AVAR_MODBUS);
               break;
             };  
             copy_P(HTMLString + strlen(HTMLString), AVAR_WORD_1);
             sprintf(HTMLString + strlen(HTMLString), "%u", ValData[3]);
             copy_P(HTMLString + strlen(HTMLString), AVAR_WORD_2);
             sprintf(HTMLString + strlen(HTMLString), "%u", ValData[4]);
             
             break;
case 17:
             copy_P(HTMLString + strlen(HTMLString), AVAR_17);
             switch (ValData[2])
             {
             case 1:
               copy_P(HTMLString + strlen(HTMLString), AVAR_CHREP);
               break;
             case 2:
               copy_P(HTMLString + strlen(HTMLString), AVAR_KP);
               break;
             case 3:
               copy_P(HTMLString + strlen(HTMLString), AVAR_MANUAL);
               break;
             };
             
             copy_P(HTMLString + strlen(HTMLString), AVAR_17_1);
             switch (ValData[3])
             {
             case 1:
               copy_P(HTMLString + strlen(HTMLString), AVAR_CHREP);
               break;
             case 2:
               copy_P(HTMLString + strlen(HTMLString), AVAR_KP);
               break;
             case 3:
               copy_P(HTMLString + strlen(HTMLString), AVAR_MANUAL);
               break;
             };
             
             //sprintf(HTMLString + strlen(HTMLString), "%d", pa[5]);
             break;
case 18:
             copy_P(HTMLString + strlen(HTMLString), AVAR_18);
             sprintf(HTMLString + strlen(HTMLString), "%u", ValData[2]);
             break;
case 19:
             copy_P(HTMLString + strlen(HTMLString), AVAR_19);
             switch (ValData[2])
             {
             case 1:
               copy_P(HTMLString + strlen(HTMLString), AVAR_MODBUS);
               break;
             case 2:
               copy_P(HTMLString + strlen(HTMLString), AVAR_PO);
               break;
             };  
             copy_P(HTMLString + strlen(HTMLString), AVAR_PWM_ERR);
             sprintf(HTMLString + strlen(HTMLString), "%u", ValData[3]);
             copy_P(HTMLString + strlen(HTMLString), AVAR_ENERGY_ERR);
             sprintf(HTMLString + strlen(HTMLString), "%u", ValData[4]);             
             break;
case 20:
             copy_P(HTMLString + strlen(HTMLString), AVAR_20);
             copy_P(HTMLString + strlen(HTMLString), html_br);
             copy_P(HTMLString + strlen(HTMLString), AVAR_20_4);
             sprintf(HTMLString + strlen(HTMLString), "%d", pa[4] * 10);
             copy_P(HTMLString + strlen(HTMLString), html_br);  
             copy_P(HTMLString + strlen(HTMLString), AVAR_20_5);
             sprintf(HTMLString + strlen(HTMLString), "%d", pa[5]);
             copy_P(HTMLString + strlen(HTMLString), html_br);
             copy_P(HTMLString + strlen(HTMLString), AVAR_20_6);
             sprintf(HTMLString + strlen(HTMLString), "%d", pa[6] * 10);
             copy_P(HTMLString + strlen(HTMLString), html_br);
             copy_P(HTMLString + strlen(HTMLString), AVAR_20_7);
             sprintf(HTMLString + strlen(HTMLString), "%d", pa[7]);
             copy_P(HTMLString + strlen(HTMLString), html_br);
             copy_P(HTMLString + strlen(HTMLString), AVAR_20_8);
             sprintf(HTMLString + strlen(HTMLString), "%d", pa[8] * 10);
             copy_P(HTMLString + strlen(HTMLString), html_br);
             copy_P(HTMLString + strlen(HTMLString), AVAR_20_9);
             sprintf(HTMLString + strlen(HTMLString), "%d", pa[9]);
             copy_P(HTMLString + strlen(HTMLString), html_br);
             break;
case 21:
             copy_P(HTMLString + strlen(HTMLString), AVAR_21);
             copy_P(HTMLString + strlen(HTMLString), AVAR_20);
             copy_P(HTMLString + strlen(HTMLString), html_br);
             copy_P(HTMLString + strlen(HTMLString), AVAR_20_4);
             sprintf(HTMLString + strlen(HTMLString), "%d", pa[4] * 10);
             copy_P(HTMLString + strlen(HTMLString), html_br);  
             copy_P(HTMLString + strlen(HTMLString), AVAR_20_5);
             sprintf(HTMLString + strlen(HTMLString), "%d", pa[5]);
             copy_P(HTMLString + strlen(HTMLString), html_br);
             copy_P(HTMLString + strlen(HTMLString), AVAR_20_6);
             sprintf(HTMLString + strlen(HTMLString), "%d", pa[6] * 10);
             copy_P(HTMLString + strlen(HTMLString), html_br);
             copy_P(HTMLString + strlen(HTMLString), AVAR_20_7);
             sprintf(HTMLString + strlen(HTMLString), "%d", pa[7]);
             copy_P(HTMLString + strlen(HTMLString), html_br);
             copy_P(HTMLString + strlen(HTMLString), AVAR_20_8);
             sprintf(HTMLString + strlen(HTMLString), "%d", pa[8] * 10);
             copy_P(HTMLString + strlen(HTMLString), html_br);
             copy_P(HTMLString + strlen(HTMLString), AVAR_20_9);
             sprintf(HTMLString + strlen(HTMLString), "%d", pa[9]);
             copy_P(HTMLString + strlen(HTMLString), html_br);
             break;
case 22:
             copy_P(HTMLString + strlen(HTMLString), AVAR_22);
             copy_P(HTMLString + strlen(HTMLString), AVAR_20);
             copy_P(HTMLString + strlen(HTMLString), html_br);
             copy_P(HTMLString + strlen(HTMLString), AVAR_20_4);
             sprintf(HTMLString + strlen(HTMLString), "%d", pa[4] * 10);
             copy_P(HTMLString + strlen(HTMLString), html_br);  
             copy_P(HTMLString + strlen(HTMLString), AVAR_20_5);
             sprintf(HTMLString + strlen(HTMLString), "%d", pa[5]);
             copy_P(HTMLString + strlen(HTMLString), html_br);
             copy_P(HTMLString + strlen(HTMLString), AVAR_20_6);
             sprintf(HTMLString + strlen(HTMLString), "%d", pa[6] * 10);
             copy_P(HTMLString + strlen(HTMLString), html_br);
             copy_P(HTMLString + strlen(HTMLString), AVAR_20_7);
             sprintf(HTMLString + strlen(HTMLString), "%d", pa[7]);
             copy_P(HTMLString + strlen(HTMLString), html_br);
             copy_P(HTMLString + strlen(HTMLString), AVAR_20_8);
             sprintf(HTMLString + strlen(HTMLString), "%d", pa[8] * 10);
             copy_P(HTMLString + strlen(HTMLString), html_br);
             copy_P(HTMLString + strlen(HTMLString), AVAR_20_9);
             sprintf(HTMLString + strlen(HTMLString), "%d", pa[9]);
             copy_P(HTMLString + strlen(HTMLString), html_br);
             break;
case 23:
             copy_P(HTMLString + strlen(HTMLString), AVAR_23);
             copy_P(HTMLString + strlen(HTMLString), AVAR_20);
             copy_P(HTMLString + strlen(HTMLString), html_br);
             copy_P(HTMLString + strlen(HTMLString), AVAR_20_4);
             sprintf(HTMLString + strlen(HTMLString), "%d", pa[4] * 10);
             copy_P(HTMLString + strlen(HTMLString), html_br);  
             copy_P(HTMLString + strlen(HTMLString), AVAR_20_5);
             sprintf(HTMLString + strlen(HTMLString), "%d", pa[5]);
             copy_P(HTMLString + strlen(HTMLString), html_br);
             copy_P(HTMLString + strlen(HTMLString), AVAR_20_6);
             sprintf(HTMLString + strlen(HTMLString), "%d", pa[6] * 10);
             copy_P(HTMLString + strlen(HTMLString), html_br);
             copy_P(HTMLString + strlen(HTMLString), AVAR_20_7);
             sprintf(HTMLString + strlen(HTMLString), "%d", pa[7]);
             copy_P(HTMLString + strlen(HTMLString), html_br);
             copy_P(HTMLString + strlen(HTMLString), AVAR_20_8);
             sprintf(HTMLString + strlen(HTMLString), "%d", pa[8] * 10);
             copy_P(HTMLString + strlen(HTMLString), html_br);
             copy_P(HTMLString + strlen(HTMLString), AVAR_20_9);
             sprintf(HTMLString + strlen(HTMLString), "%d", pa[9]);
             copy_P(HTMLString + strlen(HTMLString), html_br);
             break;
case 24:
             copy_P(HTMLString + strlen(HTMLString), AVAR_24 );
             copy_P(HTMLString + strlen(HTMLString), html_br);
             copy_P(HTMLString + strlen(HTMLString), AVAR_1_4);
             sprintf(HTMLString + strlen(HTMLString), "%d", pa[4]);
             copy_P(HTMLString + strlen(HTMLString), html_br);  
             copy_P(HTMLString + strlen(HTMLString), AVAR_1_5);
             sprintf(HTMLString + strlen(HTMLString), "%d", pa[5]);
             copy_P(HTMLString + strlen(HTMLString), html_br);
             copy_P(HTMLString + strlen(HTMLString), AVAR_1_6);
             sprintf(HTMLString + strlen(HTMLString), "%d", pa[6]);
             copy_P(HTMLString + strlen(HTMLString), html_br);
             copy_P(HTMLString + strlen(HTMLString), AVAR_1_7);
             sprintf(HTMLString + strlen(HTMLString), "%d", pa[7]);
             copy_P(HTMLString + strlen(HTMLString), html_br);
             copy_P(HTMLString + strlen(HTMLString), AVAR_1_8);
             sprintf(HTMLString + strlen(HTMLString), "%d", pa[8] * 10);
             copy_P(HTMLString + strlen(HTMLString), html_br);
             copy_P(HTMLString + strlen(HTMLString), AVAR_1_9);
             sprintf(HTMLString + strlen(HTMLString), "%d", pa[9]);
             copy_P(HTMLString + strlen(HTMLString), html_br);
             break;   
case 25:
             copy_P(HTMLString + strlen(HTMLString), AVAR_25);
             copy_P(HTMLString + strlen(HTMLString), html_br);
             copy_P(HTMLString + strlen(HTMLString), AVAR_25_4);
             sprintf(HTMLString + strlen(HTMLString), "%u", ValData[2] * 2);
             copy_P(HTMLString + strlen(HTMLString), html_br);  
             copy_P(HTMLString + strlen(HTMLString), AVAR_4_5);
             sprintf(HTMLString + strlen(HTMLString), "%d", pa[6]);
             copy_P(HTMLString + strlen(HTMLString), html_br);
             copy_P(HTMLString + strlen(HTMLString), AVAR_20_5);
             sprintf(HTMLString + strlen(HTMLString), "%d", pa[7]);
             copy_P(HTMLString + strlen(HTMLString), html_br);
             copy_P(HTMLString + strlen(HTMLString), AVAR_1_7);
             sprintf(HTMLString + strlen(HTMLString), "%d", pa[8]);
             copy_P(HTMLString + strlen(HTMLString), html_br);
             copy_P(HTMLString + strlen(HTMLString), AVAR_1_9);
             sprintf(HTMLString + strlen(HTMLString), "%d", pa[9]);
             copy_P(HTMLString + strlen(HTMLString), html_br);
             break;
case 101:
case 102:
case 103:
case 104:
case 105:
case 106:
case 107:
case 108:
case 109:

case 111:
case 112:
case 113:
case 114:
case 115:

              copy_P(HTMLString + strlen(HTMLString), AVAR_100);
              sprintf(HTMLString + strlen(HTMLString), "%d", aCode - 100);
              copy_P(HTMLString + strlen(HTMLString), html_br);
              copy_P(HTMLString + strlen(HTMLString), AVAR_100_4);
              sprintf(HTMLString + strlen(HTMLString), "%u", ValData[2]);
              copy_P(HTMLString + strlen(HTMLString), html_br);
              copy_P(HTMLString + strlen(HTMLString), AVAR_100_6);
              val_DWord.Word[0] = ValData[3];
              val_DWord.Word[1] = ValData[4];
              sprintf(HTMLString + strlen(HTMLString), "%lu", val_DWord.Value);
              copy_P(HTMLString + strlen(HTMLString), html_br);
              break;
case 116:
             // copy_P(HTMLString + strlen(HTMLString), AVAR_116_6);
             // sprintf(HTMLString + strlen(HTMLString), "%d", aCode - 100);
              copy_P(HTMLString + strlen(HTMLString), html_br);
              copy_P(HTMLString + strlen(HTMLString), AVAR_100_4);
              sprintf(HTMLString + strlen(HTMLString), "%u", ValData[2]);
              copy_P(HTMLString + strlen(HTMLString), html_br);
              copy_P(HTMLString + strlen(HTMLString), AVAR_116_6);
              val_DWord.Word[0] = ValData[3];
              val_DWord.Word[1] = ValData[4];
              sprintf(HTMLString + strlen(HTMLString), "%f", val_DWord.Value*0.001);
              copy_P(HTMLString + strlen(HTMLString), html_br);
              break;   
case 110:
             // copy_P(HTMLString + strlen(HTMLString), AVAR_110_6);
              //sprintf(HTMLString + strlen(HTMLString), "%d", aCode - 100);
              copy_P(HTMLString + strlen(HTMLString), html_br);
              copy_P(HTMLString + strlen(HTMLString), AVAR_100_4);
              sprintf(HTMLString + strlen(HTMLString), "%u", ValData[2]);
              copy_P(HTMLString + strlen(HTMLString), html_br);
              copy_P(HTMLString + strlen(HTMLString), AVAR_110_6);
              val_DWord.Word[0] = ValData[3];
              val_DWord.Word[1] = ValData[4];
              sprintf(HTMLString + strlen(HTMLString), "%lu", val_DWord.Value/2);
              copy_P(HTMLString + strlen(HTMLString), html_br);
              break;            
              
              
default: 
                          {
                             copy_P(HTMLString + strlen(HTMLString), AVAR_NAN );
                             break;
                          }
 }  // end switch

}
*/